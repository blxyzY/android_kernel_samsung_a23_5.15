/* Copyright (c) 2019, The Linux Foundation. All rights reserved.
 *
 * This program is free software; you can redistribute it and/or modify
 * it under the terms of the GNU General Public License version 2 and
 * only version 2 as published by the Free Software Foundation.
 *
 * This program is distributed in the hope that it will be useful,
 * but WITHOUT ANY WARRANTY; without even the implied warranty of
 * MERCHANTABILITY or FITNESS FOR A PARTICULAR PURPOSE.  See the
 * GNU General Public License for more details.
 */

/*
 * Persistent console for bring-up. The base DTB's ramoops_region is disabled and
 * has no fixed address, so a crash log would not survive a reboot.
 *
 * Layout is chosen so the CONSOLE zone lands exactly where the stock 4.19 kernel
 * keeps its own: stock has ramoops@78c00000 (1 MiB; dmesg 0x40000, console 0x40000,
 * ftrace 0x40000, pmsg 0x40000), i.e. console at 0x78c40000-0x78c80000. After a
 * failed 5.15 boot, flash the stock boot.img back and the stock kernel can read
 * /sys/fs/pstore/console-ramoops-0 with the 5.15 log in it (no display needed).
 *
 *   0x78c20000  dmesg    0x20000  (1 record)
 *   0x78c40000  console  0x40000  <- same address and size as stock
 *   0x78c80000  pmsg     0x20000  (stock sees this as its ftrace zone; harmless)
 *
 * ram.c zone order is dmesg, console, ftrace, pmsg and every size must be a power
 * of two. The range is free in the Samsung map: google_debug_kinfo_region@78c00000
 * is only 4 KiB and sec_qcom_rdx_bootdev_region starts at 0x78d00000.
 */
&reserved_memory {
	a23_ramoops: ramoops@78c20000 {
		compatible = "ramoops";
		reg = <0x0 0x78c20000 0x0 0x80000>;
		no-map;
		record-size = <0x20000>;
		console-size = <0x40000>;
		pmsg-size = <0x20000>;
		mem-type = <0x02>;	/* noncached: survives a warm reset */
		max-reason = <2>;	/* panic + oops */
	};
};
