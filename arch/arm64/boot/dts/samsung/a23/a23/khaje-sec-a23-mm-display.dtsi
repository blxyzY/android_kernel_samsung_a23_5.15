// SPDX-License-Identifier: GPL-2.0
/*
 * Galaxy A23 4G: display nodes carried over from 4.19.
 * These target labels that the khaje base DTB (CLO 5.15) does not
 * define; they are provided by the separate Qualcomm display/audio/
 * camera devicetree repos. Built as their own dtbo, not merged into the
 * core DTB.
 */

/* from a23/a23_eur_open_w00_r08.dts */
/* #include "../../display_PBA_BOOTING.dtsi" */      /* From display_PBA_BOOTING.py */
/* Copyright (c) 2013-2014, The Linux Foundation. All rights reserved.
 *
 * This program is free software; you can redistribute it and/or modify
 * it under the terms of the GNU General Public License version 2 and
 * only version 2 as published by the Free Software Foundation.
 *
 * This program is distributed in the hope that it will be useful,
 * but WITHOUT ANY WARRANTY; without even the implied warranty of
 * MERCHANTABILITY or FITNESS FOR A PARTICULAR PURPOSE.  See the
 * GNU General Public License for more details.
 */

/*---------------------------------------------------------------------------
 * This file is autogenerated file using gcdb parser. Please do not edit it.
 * Update input XML file to add a new entry or update variable in this file
 * VERSION = "1.0"
 *---------------------------------------------------------------------------

 */
&mdss_mdp {
	ss_dsi_panel_PBA_BOOTING_FHD: ss_dsi_panel_PBA_BOOTING_FHD {
		qcom,mdss-dsi-panel-name = "ss_dsi_panel_PBA_BOOTING_FHD";
		label = "ss_dsi_panel_PBA_BOOTING_FHD";

		qcom,mdss-dsi-bpp = <24>;

		qcom,mdss-dsi-underflow-color = <0xFF>;
		qcom,mdss-dsi-border-color = <0>;

		qcom,mdss-dsi-bl-pmic-control-type = "bl_ctrl_dcs";

		qcom,mdss-dsi-bl-min-level = <0>;
		qcom,mdss-dsi-bl-max-level = <25500>;
		qcom,mdss-brightness-max-level = <25500>;
		qcom,mdss-dsi-interleave-mode = <0>;
		qcom,mdss-dsi-panel-type = "dsi_video_mode";
		qcom,mdss-dsi-traffic-mode = "burst_mode";
		qcom,mdss-dsi-bllp-eof-power-mode;
		qcom,mdss-dsi-bllp-power-mode;

		qcom,mdss-dsi-pixel-packing = "loose";

		qcom,mdss-dsi-virtual-channel-id = <0>;
		qcom,mdss-dsi-color-order = "rgb_swap_rgb";
		qcom,mdss-dsi-lane-0-state;
		qcom,mdss-dsi-lane-1-state;
		qcom,mdss-dsi-lane-2-state;
		qcom,mdss-dsi-lane-3-state;

		qcom,mdss-dsi-stream = <0>;
		qcom,mdss-dsi-mdp-trigger = "none";
		qcom,mdss-dsi-dma-trigger = "trigger_sw";

		qcom,mdss-pan-physical-width-dimension = <60>;
		qcom,mdss-pan-physical-height-dimension = <106>;

		qcom,mdss-dsi-panel-mode-gpio-state = "invalid";
		qcom,mdss-dsi-reset-sequence = <0 10>, <1 10>;
		qcom,adjust-timer-wakeup-ms = <1>;

		qcom,mdss-dsi-lp11-init;

		qcom,mdss-dsi-rx-eot-ignore;
		qcom,mdss-dsi-tx-eot-append;

		/*
		* ************************************************************************************************************************
		* candela to index mappings
		* ************************************************************************************************************************
		*/
		samsung,candela_map_table_revA = <
		/*<idx>	  <from>  <till> <candella> */
			0	0	2	5
			1	2	2	6
			2	3	3	7
			3	4	4	8
			4	5	5	9
			5	6	6	10
			6	7	7	11
			7	8	8	12
			8	9	9	13
			9	10	10	14
			10	11	11	15
			11	12	12	16
			12	13	13	17
			13	14	14	19
			14	15	15	20
			15	16	16	21
			16	17	17	22
			17	18	18	24
			18	19	19	25
			19	20	20	27
			20	21	21	29
			21	22	22	30
			22	23	24	32
			23	25	26	34
			24	27	28	37
			25	29	29	39
			26	30	32	41
			27	33	34	44
			28	35	36	47
			29	37	38	50
			30	39	40	53
			31	41	43	56
			32	44	46	60
			33	47	49	64
			34	50	52	68
			35	53	56	72
			36	57	59	77
			37	60	63	82
			38	64	67	87
			39	68	71	93
			40	72	76	98
			41	77	80	105
			42	81	86	111
			43	87	91	119
			44	92	97	126
			45	98	104	134
			46	105	110	143
			47	111	118	152
			48	119	125	162
			49	126	133	172
			50	134	142	183
			51	143	150	195
			52	151	160	207
			53	161	170	220
			54	171	181	234
			55	182	193	249
			56	194	205	265
			57	206	218	282
			58	219	230	300
			59	231	242	316
			60	243	254	333
			61	255	255	360
		>;


		/*
		* ************************************************************************************************************************
		* DMS (Dynamic Mode Switch)
		* (PBA does not support MULTI_RESOLUTION, only FHD.)
		* ************************************************************************************************************************
		*/

		qcom,mdss-dsi-display-timings {
			fhd@0 {
				qcom,display-topology = <1 0 1>;
				qcom,default-topology-index = <0>;

				qcom,mdss-dsi-panel-width = <1080>;
				qcom,mdss-dsi-panel-height = <1920>;
				qcom,mdss-dsi-panel-framerate = <60>;
				qcom,mdss-dsi-h-pulse-width = <12>;
				qcom,mdss-dsi-h-back-porch = <32>;
				qcom,mdss-dsi-h-front-porch = <164>;
				qcom,mdss-dsi-h-sync-skew = <0>;
				qcom,mdss-dsi-v-pulse-width = <4>;
				qcom,mdss-dsi-v-back-porch = <3>;
				qcom,mdss-dsi-v-front-porch = <9>;

				qcom,mdss-dsi-panel-clockrate = <898000000>;
				qcom,mdss-dsi-panel-phy-timings = [00 1B 08 07 0D 0B 08 08 05 02 04 00 17 0C];

				qcom,mdss-dsi-on-command = [
					39 01 00 00 78 00 02 11 00	/* sleep out.  It use last packet*/
				];
				qcom,mdss-dsi-off-command = [
					05 01 00 00 24 00 01 28				/* wait 40ms(0x24) */
					05 01 00 00 78 00 01 10				/* wait 120ms(0x78) */
				];

				qcom,mdss-dsi-on-command-state = "dsi_hs_mode";
				qcom,mdss-dsi-off-command-state = "dsi_hs_mode";
			};
		};
	};
};

/* from a23/a23_eur_open_w00_r08.dts */
&ss_dsi_panel_PBA_BOOTING_FHD {
	qcom,display-type = "primary";
	qcom,dsi-ctrl-num = <0>;
	qcom,dsi-phy-num = <0>;

	/delete-property/ qcom,panel-mode-gpio;

	qcom,platform-reset-gpio = <SEC_GPIO_REF(AP,tlmm,111) 0>;

	qcom,panel-supply-entries
	{
		#address-cells = <1>;
		#size-cells = <0>;

	};
};

/* from a23/a23_eur_open_w00_r08.dts */
/* #include "../../display_NT36672C_PM6585JB3.dtsi" *//* From display_NT36672C_PM6585JB3.py */
/* Copyright (c) 2013-14, Samsung Electronics Corporation. All rights reserved.
 *
 * This program is free software; you can redistribute it and/or modify
 * it under the terms of the GNU General Public License version 2 and
 * only version 2 as published by the Free Software Foundation.
 *
 * This program is distributed in the hope that it will be useful,
 * but WITHOUT ANY WARRANTY; without even the implied warranty of
 * MERCHANTABILITY or FITNESS FOR A PARTICULAR PURPOSE.  See the
 * GNU General Public License for more details.
 */

/*---------------------------------------------------------------------------
 * This file is autogenerated file using gcdb parser. Please do not edit it.
 * Update input XML file to add a new entry or update variable in this file
 * VERSION = "1.0"
 *---------------------------------------------------------------------------*/
&mdss_mdp {
	ss_dsi_panel_NT36672C_PM6585JB3_FHD: ss_dsi_panel_NT36672C_PM6585JB3_FHD {
		qcom,mdss-dsi-panel-name = "ss_dsi_panel_NT36672C_PM6585JB3_FHD";
		label = "ss_dsi_panel_NT36672C_PM6585JB3_FHD";

		qcom,mdss-dsi-bpp = <24>;

		/*qcom,cmd-sync-wait-broadcast;*/

		qcom,mdss-dsi-h-left-border = <0>;
		qcom,mdss-dsi-h-right-border = <0>;
		qcom,mdss-dsi-v-top-border = <0>;
		qcom,mdss-dsi-v-bottom-border = <0>;

		qcom,mdss-dsi-underflow-color = <0xFF>;
		qcom,mdss-dsi-border-color = <0>;

		qcom,mdss-dsi-bl-pmic-control-type = "bl_ctrl_dcs";

		qcom,mdss-dsi-bl-min-level = <1>;
		qcom,mdss-dsi-bl-max-level = <425>;
		qcom,mdss-brightness-max-level = <425>;
		qcom,mdss-brightness-default-level = <255>;
		qcom,mdss-dsi-interleave-mode = <0>;
		qcom,mdss-dsi-panel-type = "dsi_video_mode";

		/*qcom,dynamic-mode-switch-enabled;*/
		/*qcom,dynamic-mode-switch-type = "dynamic-resolution-switch-immediate";*/

		qcom,mdss-dsi-te-dcs-command = <1>;
		qcom,mdss-dsi-wr-mem-start = <0x2C>;
		qcom,mdss-dsi-wr-mem-continue = <0x3C>;

		qcom,mdss-dsi-pixel-packing = "loose";

		qcom,mdss-dsi-virtual-channel-id = <0>;
		qcom,mdss-dsi-color-order = "rgb_swap_rgb";
		qcom,mdss-dsi-lane-0-state;
		qcom,mdss-dsi-lane-1-state;
		qcom,mdss-dsi-lane-2-state;
		qcom,mdss-dsi-lane-3-state;
		//qcom,mdss-dsi-lane-map = "lane_map_0123";

		qcom,mdss-dsi-t-clk-pre = <0x1F>;
		qcom,mdss-dsi-t-clk-post = <0x0F>;

		qcom,mdss-dsi-bllp-eof-power-mode;
		qcom,mdss-dsi-bllp-power-mode;

		/*qcom,mdss-dsi-force-clock-lane-hs; to prevent esd, use non-continuous mode clock */

		qcom,mdss-dsi-stream = <0>;
		qcom,mdss-dsi-mdp-trigger = "none";
		qcom,mdss-dsi-dma-trigger = "trigger_sw";

		qcom,mdss-pan-physical-width-dimension = <68>;  /* 68.43, round-off */
		qcom,mdss-pan-physical-height-dimension = <152>; /* 152.57, round-off */

		qcom,mdss-dsi-reset-sequence = <1 1>, <0 1>, <1 1>;
		/*qcom,mdss-dsi-lp11-init; should turn on vddi before lp11 */
		/*qcom,mdss-dsi-init-delay-us = <1000>;*/

		qcom,mdss-dsi-rx-eot-ignore;
		qcom,mdss-dsi-tx-eot-append;

		qcom,bl-update-flag = "delay_until_first_frame";

		/* HDR Setting */
		qcom,mdss-dsi-panel-hdr-enabled;
		qcom,mdss-dsi-panel-hdr-color-primaries = <15635 16450 34000 16000 13250 34500 7500 3000>;
		qcom,mdss-dsi-panel-peak-brightness = <4000000>;
		qcom,mdss-dsi-panel-average-brightness = <1200000>;
		qcom,mdss-dsi-panel-blackness-level = <5>;

		qcom,suspend-ulps-enabled; /* enable ulps to prevent vddi floating by DDI's LP11 state */

		qcom,esd-check-enabled;
		samsung,esd-irq-trigger1 = "falling"; /* FG_ERR */
		qcom,mdss-dsi-panel-status-check-mode ="irq_check";

		/*qcom,mdss-dsi-panel-status-irq-trigger1 = "falling";*/
		/*qcom,mdss-dsi-panel-status-read-length;*/
		/*qcom,mdss-dsi-panel-status-value;*/
		/*qcom,mdss-dsi-panel-status-irq-trigger1 = "rising"; FG_ERR*/

		/* VRR for video mode */
		qcom,dsi-supported-dfps-list = <90 60>;
		qcom,mdss-dsi-pan-enable-dynamic-fps;
		qcom,mdss-dsi-pan-fps-update = "dfps_immediate_porch_mode_vfp";

		/* *************************************************************
		 * Below  parameters are samsung dependent thigs
		 * *************************************************************
		 */
		samsung,panel-vendor = "CSO";
		samsung,disp-model = "PM6585JB3";
		samsung,esc-clk-128M;
		samsung,tft-common-support;
		//samsung,lp11_sleep_ms_time = <60>;
		samsung,support_factory_panel_swap;
		samsung,pll_ssc_disabled;
		//samsung,aot_enable;
		samsung,aot_reset_regulator_late;

		/* *************************************************************
		 *  Tx
		 * *************************************************************
		 */

		samsung,packet_size_tx_cmds_revA = [ 37 01 00 00 00 00 02 07 00 ];

		/* transmit sleep out and display on commands in
		 * qcom,mdss-dsi-on-command for display on sequence spec.
		 * op code spec: send sleep out and display on command before MIPI HS mode.
		 * samsung,display_on_tx_cmds_revA = "W 0x11
Delay 105ms
W 0x29";
		 */

		/* *************************************************************
		 *  Rx (Module Information READ)
		 * *************************************************************
		 */

		/* Change mipi type from 0x06 to 0x14 for normal mipi read response */
		samsung,manufacture_id0_rx_cmds_revA	= "R 0xDA 0x01";
		samsung,manufacture_id1_rx_cmds_revA	= "R 0xDB 0x01";
		samsung,manufacture_id2_rx_cmds_revA	= "R 0xDC 0x01";

		samsung,mtp_read_sysfs_rx_cmds_revA	= [06 01 00 00 00 00 01 00 00 00];
		samsung,mtp_write_sysfs_tx_cmds_revA	= [
			29 00 00 00 00 00 3D 00
						00 00 00 00 00 00 00 00 00 00
						00 00 00 00 00 00 00 00 00 00
						00 00 00 00 00 00 00 00 00 00
						00 00 00 00 00 00 00 00 00 00
						00 00 00 00 00 00 00 00 00 00
						00 00 00 00 00 00 00 00 00 00
		];

 		samsung,brightness_tx_cmds_revA = [
			39 01 00 00 00 00 02 51 7F /* 00=off, 01=2/256, FF=256/256, 8 bits */
		];

		 /* 00=off, 01=2/256, FF=256/256, 8 bits */
		samsung,ss_brightness_tx_cmds_revA = "W 0x51 0x7F";


		/*
		 * ************************************************************************************************************************
		 * candela to index mappings
		 * ************************************************************************************************************************
		 */
		samsung,candela_map_table_revA = <
		/* THIS TABLE USED FOR SMART-DIMMING */
		/*<idx>   <from>  <till> <candella> */
			0	0	0	0
			1	1	1	1
			2	2	2	1
			3	3	3	2
			4	4	4	2
			5	5	5	3
			6	6	6	3
			7	7	7	3
			8	8	8	4
			9	9	9	4
			10	10	10	5
			11	11	11	5
			12	12	12	6
			13	13	13	6
			14	14	14	7
			15	15	15	7
			16	16	16	8
			17	17	17	8
			18	18	18	9
			19	19	19	9
			20	20	20	10
			21	21	21	10
			22	22	22	11
			23	23	23	11
			24	24	24	12
			25	25	25	12
			26	26	26	13
			27	27	27	13
			28	28	28	14
			29	29	29	14
			30	30	30	15
			31	31	31	15
			32	32	32	16
			33	33	33	16
			34	34	34	17
			35	35	35	17
			36	36	36	18
			37	37	37	18
			38	38	38	19
			39	39	39	19
			40	40	40	20
			41	41	41	20
			42	42	42	20
			43	43	43	21
			44	44	44	21
			45	45	45	22
			46	46	46	22
			47	47	47	23
			48	48	48	23
			49	49	49	24
			50	50	50	24
			51	51	51	25
			52	52	52	25
			53	53	53	26
			54	54	54	26
			55	55	55	27
			56	56	56	27
			57	57	57	28
			58	58	58	28
			59	59	59	29
			60	60	60	29
			61	61	61	30
			62	62	62	30
			63	63	63	31
			64	64	64	32
			65	65	65	32
			66	66	66	33
			67	67	67	34
			68	68	68	34
			69	69	69	35
			70	70	70	35
			71	71	71	36
			72	72	72	37
			73	73	73	37
			74	74	74	38
			75	75	75	39
			76	76	76	39
			77	77	77	40
			78	78	78	41
			79	79	79	41
			80	80	80	42
			81	81	81	43
			82	82	82	43
			83	83	83	44
			84	84	84	45
			85	85	85	45
			86	86	86	46
			87	87	87	46
			88	88	88	47
			89	89	89	48
			90	90	90	48
			91	91	91	49
			92	92	92	50
			93	93	93	50
			94	94	94	51
			95	95	95	52
			96	96	96	52
			97	97	97	53
			98	98	98	54
			99	99	99	54
			100	100	100	55
			101	101	101	56
			102	102	102	56
			103	103	103	57
			104	104	104	57
			105	105	105	58
			106	106	106	59
			107	107	107	59
			108	108	108	60
			109	109	109	61
			110	110	110	61
			111	111	111	62
			112	112	112	63
			113	113	113	63
			114	114	114	64
			115	115	115	65
			116	116	116	65
			117	117	117	66
			118	118	118	67
			119	119	119	67
			120	120	120	68
			121	121	121	68
			122	122	122	69
			123	123	123	70
			124	124	124	70
			125	125	125	71
			126	126	126	72
			127	127	127	72
			128	128	128	73
			129	129	129	74
			130	130	130	75
			131	131	131	76
			132	132	132	77
			133	133	133	77
			134	134	134	78
			135	135	135	79
			136	136	136	80
			137	137	137	81
			138	138	138	82
			139	139	139	83
			140	140	140	84
			141	141	141	84
			142	142	142	85
			143	143	143	86
			144	144	144	87
			145	145	145	88
			146	146	146	89
			147	147	147	90
			148	148	148	91
			149	149	149	91
			150	150	150	92
			151	151	151	93
			152	152	152	94
			153	153	153	95
			154	154	154	96
			155	155	155	97
			156	156	156	98
			157	157	157	98
			158	158	158	99
			159	159	159	100
			160	160	160	101
			161	161	161	102
			162	162	162	103
			163	163	163	104
			164	164	164	105
			165	165	165	105
			166	166	166	106
			167	167	167	107
			168	168	168	108
			169	169	169	109
			170	170	170	110
			171	171	171	111
			172	172	172	112
			173	173	173	112
			174	174	174	113
			175	175	175	114
			176	176	176	115
			177	177	177	116
			178	178	178	117
			179	179	179	118
			180	180	180	119
			181	181	181	119
			182	182	182	120
			183	183	183	121
			184	184	184	122
			185	185	185	123
			186	186	186	124
			187	187	187	125
			188	188	188	126
			189	189	189	126
			190	190	190	127
			191	191	191	128
			192	192	192	129
			193	193	193	130
			194	194	194	131
			195	195	195	132
			196	196	196	133
			197	197	197	134
			198	198	198	135
			199	199	199	135
			200	200	200	136
			201	201	201	137
			202	202	202	138
			203	203	203	139
			204	204	204	140
			205	205	205	141
			206	206	206	142
			207	207	207	143
			208	208	208	144
			209	209	209	145
			210	210	210	146
			211	211	211	146
			212	212	212	147
			213	213	213	148
			214	214	214	149
			215	215	215	150
			216	216	216	151
			217	217	217	152
			218	218	218	153
			219	219	219	154
			220	220	220	155
			221	221	221	156
			222	222	222	157
			223	223	223	158
			224	224	224	158
			225	225	225	159
			226	226	226	160
			227	227	227	161
			228	228	228	162
			229	229	229	163
			230	230	230	164
			231	231	231	165
			232	232	232	166
			233	233	233	167
			234	234	234	168
			235	235	235	169
			236	236	236	170
			237	237	237	170
			238	238	238	171
			239	239	239	172
			240	240	240	173
			241	241	241	174
			242	242	242	175
			243	243	243	176
			244	244	244	177
			245	245	245	178
			246	246	246	179
			247	247	247	180
			248	248	248	181
			249	249	249	181
			250	250	250	182
			251	251	251	183
			252	252	252	184
			253	253	253	185
			254	254	254	186
			255	255	255	187
			256	256	256	188
			257	257	257	189
			258	258	258	189
			259	259	259	190
			260	260	260	191
			261	261	261	192
			262	262	262	192
			263	263	263	193
			264	264	264	194
			265	265	265	195
			266	266	266	195
			267	267	267	196
			268	268	268	197
			269	269	269	198
			270	270	270	198
			271	271	271	199
			272	272	272	200
			273	273	273	201
			274	274	274	202
			275	275	275	202
			276	276	276	203
			277	277	277	204
			278	278	278	205
			279	279	279	205
			280	280	280	206
			281	281	281	207
			282	282	282	208
			283	283	283	208
			284	284	284	209
			285	285	285	210
			286	286	286	211
			287	287	287	211
			288	288	288	212
			289	289	289	213
			290	290	290	214
			291	291	291	215
			292	292	292	215
			293	293	293	216
			294	294	294	217
			295	295	295	218
			296	296	296	218
			297	297	297	219
			298	298	298	220
			299	299	299	221
			300	300	300	221
			301	301	301	222
			302	302	302	223
			303	303	303	224
			304	304	304	224
			305	305	305	225
			306	306	306	226
		>;

		samsung,support_ss_cmd;
		samsung,ss_cmd_dsc_long_write; /* 39h instead of 29h */
		/* samsung,ss_cmd_dsc_short_write_param;  15h instead of 05h */

		/*
		* ************************************************************************************************************************
		* MULTI_RESOLUTION (DSC configs were moved all to below timing set)
		* ************************************************************************************************************************
		*/

		/* transmit sleep out and display on commands in
		 * qcom,mdss-dsi-on-command for display on sequence spec.
		 * op code spec: send sleep out and display on command before MIPI HS mode.
		 */
		samsung,mdss_dsi_on_tx_cmds_revA = "W 0xFF 0x10
W 0xFB 0x01
W 0xB0 0x01
W 0xC1 0x89 0x28 0x00 0x08 0x00 0xAA 0x02 0x0E 0x00 0x2B 0x00 0x07 0x0D 0xB7 0x0C 0xB7
W 0xC2 0x1B 0xA0
W 0xFF 0x20
W 0xFB 0x01
W 0x01 0x66
W 0x06 0x64
W 0x07 0x28
W 0x17 0x66
W 0x1B 0x01
W 0x1F 0x02
W 0x20 0x03
W 0x5C 0x90
W 0x5E 0xB0
W 0x69 0xD0
W 0x95 0xD1
W 0x96 0xD1
W 0xF2 0x66
W 0xF3 0x54
W 0xF4 0x66
W 0xF5 0x54
W 0xF6 0x66
W 0xF7 0x54
W 0xF8 0x66
W 0xF9 0x54
W 0xFF 0x21
W 0xFB 0x01
W 0xFF 0x24
W 0xFB 0x01
W 0x00 0x26
W 0x01 0x13
W 0x02 0x27
W 0x03 0x15
W 0x04 0x28
W 0x05 0x17
W 0x07 0x24
W 0x08 0x24
W 0x0A 0x22
W 0x0C 0x10
W 0x0D 0x0F
W 0x0E 0x01
W 0x10 0x2D
W 0x11 0x2F
W 0x12 0x31
W 0x13 0x33
W 0x15 0x0B
W 0x17 0x0C
W 0x18 0x26
W 0x19 0x13
W 0x1A 0x27
W 0x1B 0x15
W 0x1C 0x28
W 0x1D 0x17
W 0x1F 0x24
W 0x20 0x24
W 0x22 0x22
W 0x24 0x10
W 0x25 0x0F
W 0x26 0x01
W 0x28 0x2C
W 0x29 0x2E
W 0x2A 0x30
W 0x2B 0x32
W 0x2F 0x0B
W 0x31 0x0C
W 0x32 0x09
W 0x33 0x03
W 0x34 0x03
W 0x35 0x07
W 0x36 0x3C
W 0x4E 0x37
W 0x4F 0x37
W 0x53 0x37
W 0x77 0x80
W 0x79 0x22
W 0x7A 0x03
W 0x7B 0x8E
W 0x7D 0x04
W 0x80 0x04
W 0x81 0x04
W 0x82 0x13
W 0x84 0x31
W 0x85 0x13
W 0x86 0x22
W 0x87 0x31
W 0x90 0x13
W 0x92 0x31
W 0x93 0x13
W 0x94 0x22
W 0x95 0x31
W 0x9C 0xF4
W 0x9D 0x01
W 0xA0 0x0E
W 0xA2 0x0E
W 0xA3 0x03
W 0xA4 0x04
W 0xA5 0x04
W 0xC4 0x80
W 0xC6 0xC0
W 0xC9 0x00
W 0xD9 0x80
W 0xE9 0x03
W 0xFF 0x25
W 0xFB 0x01
W 0x0F 0x1B
W 0x18 0x21
W 0x19 0xE4
W 0x21 0x40
W 0x63 0x8F
W 0x66 0x5D
W 0x67 0x16
W 0x68 0x58
W 0x69 0x10
W 0x6B 0x00
W 0x70 0xE5
W 0x71 0x6D
W 0x77 0x62
W 0x7E 0x2D
W 0x84 0x78
W 0x85 0x75
W 0x8D 0x04
W 0xC1 0xA9
W 0xC2 0x5A
W 0xC3 0x07
W 0xC4 0x11
W 0xC6 0x11
W 0xF0 0x05
W 0xEF 0x28
W 0xF1 0x14
W 0xFF 0x26
W 0xFB 0x01
W 0x00 0x10
W 0x01 0xFB
W 0x03 0x00
W 0x04 0xFB
W 0x05 0x08
W 0x06 0x13
W 0x08 0x13
W 0x14 0x06
W 0x15 0x01
W 0x74 0xAF
W 0x81 0x0E
W 0x83 0x03
W 0x84 0x03
W 0x85 0x01
W 0x86 0x03
W 0x87 0x01
W 0x88 0x07
W 0x8A 0x1A
W 0x8B 0x11
W 0x8C 0x24
W 0x8E 0x42
W 0x8F 0x11
W 0x90 0x11
W 0x91 0x11
W 0x9A 0x80
W 0x9B 0x04
W 0x9C 0x00
W 0x9D 0x00
W 0x9E 0x00
W 0xFF 0x27
W 0xFB 0x01
W 0x01 0x68
W 0x20 0x81
W 0x21 0x6F
W 0x25 0x81
W 0x26 0x97
W 0x3F 0x10
W 0x40 0x55
W 0x43 0x10
W 0x4E 0x05
W 0x6E 0x12
W 0x6F 0x00
W 0x70 0x00
W 0x71 0x00
W 0x72 0x00
W 0x73 0x76
W 0x74 0x10
W 0x75 0x32
W 0x76 0x54
W 0x77 0x00
W 0x7D 0x09
W 0x7E 0x6B
W 0x80 0x27
W 0x82 0x09
W 0x83 0x6B
W 0x88 0x03
W 0x89 0x03
W 0xE3 0x01
W 0xE4 0xE9
W 0xE5 0x02
W 0xE6 0xDE
W 0xE9 0x02
W 0xEA 0x1E
W 0xEB 0x03
W 0xEC 0x2D
W 0xFF 0x2A
W 0xFB 0x01
W 0x00 0x91
W 0x03 0x20
W 0x06 0x06
W 0x07 0x50
W 0x0A 0x60
W 0x0C 0x04
W 0x0D 0x40
W 0x0F 0x01
W 0x11 0xE1
W 0x15 0x0F
W 0x16 0xBE
W 0x19 0x0F
W 0x1A 0x92
W 0x1B 0x12
W 0x1D 0x36
W 0x1E 0x3F
W 0x1F 0x48
W 0x20 0x3F
W 0x27 0x00
W 0x28 0xFD
W 0x29 0x0B
W 0x2A 0x1B
W 0x2D 0x0B
W 0x2F 0x01
W 0x30 0x85
W 0x31 0xB4
W 0x33 0x22
W 0x34 0xFF
W 0x35 0x3F
W 0x36 0x05
W 0x37 0xF9
W 0x38 0x44
W 0x39 0x00
W 0x3A 0x85
W 0x45 0x04
W 0x46 0x40
W 0x48 0x01
W 0x4A 0xE1
W 0x4E 0x0F
W 0x4F 0xBE
W 0x52 0x0F
W 0x53 0x92
W 0x54 0x12
W 0x56 0x36
W 0x57 0x57
W 0x58 0x61
W 0x59 0x57
W 0x60 0x00
W 0x61 0xFD
W 0x62 0x05
W 0x63 0x79
W 0x65 0x08
W 0x66 0x01
W 0x67 0x43
W 0x68 0xC9
W 0x69 0x32
W 0x6A 0xE3
W 0x6B 0xFF
W 0x6C 0x2E
W 0x6D 0xA3
W 0x6E 0xFB
W 0x6F 0x31
W 0x70 0xA0
W 0x71 0x43
W 0x7A 0x09
W 0x7B 0x40
W 0x7F 0xF0
W 0x83 0x0F
W 0x84 0xBE
W 0x87 0x0F
W 0x88 0x92
W 0x89 0x12
W 0x8B 0x36
W 0x8C 0x7E
W 0x8D 0x7E
W 0x8E 0x7E
W 0xFF 0x2C
W 0xFB 0x01
W 0x03 0x15
W 0x04 0x15
W 0x05 0x15
W 0x0D 0x06
W 0x0E 0x56
W 0x17 0x4E
W 0x18 0x4E
W 0x19 0x4E
W 0x2D 0xAF
W 0x2F 0x10
W 0x30 0xFC
W 0x32 0x00
W 0x33 0xFC
W 0x35 0x19
W 0x37 0x19
W 0x4D 0x15
W 0x4E 0x04
W 0x4F 0x09
W 0x56 0x1B
W 0x58 0x1B
W 0x59 0x1B
W 0x62 0x6D
W 0x6B 0x6A
W 0x6C 0x6A
W 0x6D 0x6A
W 0x80 0xAF
W 0x81 0x10
W 0x82 0xFC
W 0x84 0x00
W 0x85 0xFC
W 0x87 0x20
W 0x89 0x20
W 0x9E 0x04
W 0x9F 0x1E
W 0xFF 0xE0
W 0xFB 0x01
W 0x35 0x82
W 0xFF 0xF0
W 0xFB 0x01
W 0x1C 0x01
W 0x33 0x01
W 0x5A 0x00
W 0xFF 0xD0
W 0xFB 0x01
W 0x53 0x22
W 0x54 0x02
W 0xFF 0xC0
W 0xFB 0x01
W 0x9C 0x11
W 0x9D 0x11
W 0xFF 0x2B
W 0xFB 0x01
W 0xB7 0x1A
W 0xB8 0x19
W 0xC0 0x03
W 0xFF 0xF0
W 0xFB 0x01
W 0xD2 0x50
W 0xFF 0x23
W 0xFB 0x01
W 0x00 0x00
W 0x07 0x60
W 0x08 0x06
W 0x09 0x1C
W 0x0A 0x2B
W 0x0B 0x2B
W 0x0C 0x2B
W 0x0D 0x00
W 0x10 0x50
W 0x11 0x01
W 0x12 0x95
W 0x15 0x68
W 0x16 0x0B
W 0x19 0x00
W 0x1A 0x00
W 0x1B 0x00
W 0x1C 0x00
W 0x1D 0x01
W 0x1E 0x03
W 0x1F 0x05
W 0x20 0x0C
W 0x21 0x13
W 0x22 0x17
W 0x23 0x1D
W 0x24 0x23
W 0x25 0x2C
W 0x26 0x33
W 0x27 0x39
W 0x28 0x3F
W 0x29 0x3F
W 0x2A 0x3F
W 0x2B 0x3F
W 0x30 0xFF
W 0x31 0xFE
W 0x32 0xFD
W 0x33 0xFC
W 0x34 0xFB
W 0x35 0xFA
W 0x36 0xF9
W 0x37 0xF7
W 0x38 0xF5
W 0x39 0xF3
W 0x3A 0xF1
W 0x3B 0xEE
W 0x3D 0xEC
W 0x3F 0xEA
W 0x40 0xE8
W 0x41 0xE6
W 0x04 0x00
W 0xA0 0x11
W 0xFF 0x10
W 0xFB 0x01
W 0x53 0x2C
W 0x55 0x01
W 0x68 0x00 0x01
						    W 0x11
Delay 105ms
W 0x29";
		samsung,mdss_dsi_on_tx_cmds_revA_lp; /* Without this feature, whole ss commands be sent on HS mode */

		samsung,mdss_dsi_off_tx_cmds_revA = "W 0x28
Delay 20ms
W 0x10
Delay 60ms";

		qcom,mdss-dsi-display-timings {
			fhd {
				qcom,display-topology = <1 1 1>;
				qcom,default-topology-index = <0>;

				qcom,mdss-dsi-panel-width = <1080>;
				qcom,mdss-dsi-panel-height = <2408>;

				qcom,mdss-dsi-h-pulse-width = <8>;
				qcom,mdss-dsi-h-back-porch = <20>;
				qcom,mdss-dsi-h-front-porch = <452>;
				qcom,mdss-dsi-h-sync-skew = <0>;
				qcom,mdss-dsi-v-pulse-width = <8>;
				qcom,mdss-dsi-v-back-porch = <10>;
				qcom,mdss-dsi-v-front-porch = <54>;
				qcom,mdss-dsi-panel-clockrate = <1125000000>; /* 1125 Mbps*/

				qcom,mdss-dsi-panel-phy-timings = [00 25 0A 0A 1B 24 0A 0A 0A 02 04 00 1F 0F];

				qcom,mdss-dsi-t-clk-pre = <0x1F>;
				qcom,mdss-dsi-t-clk-post = <0x0F>;

				qcom,mdss-dsi-panel-framerate = <90>;
				/* qcom,mdss-mdp-transfer-time-us = <7533>; */

				/*qcom,mdss-dsi-timing-switch-command; use samsung,panel_multires_XXX instead*/
				/*qcom,mdss-dsi-timing-switch-command-state;*/

				qcom,mdss-dsi-on-command-state = "dsi_lp_mode";
				qcom,mdss-dsi-off-command-state = "dsi_hs_mode";

				qcom,compression-mode = "dsc";
				qcom,mdss-dsc-version = <0x11>;
				qcom,mdss-dsc-scr-version = <0>;
				qcom,mdss-dsc-slice-height = <8>;
				qcom,mdss-dsc-slice-width = <540>;
				qcom,mdss-dsc-slice-per-pkt = <1>;
				qcom,mdss-dsc-bit-per-component = <8>;
				qcom,mdss-dsc-bit-per-pixel = <8>;
				qcom,mdss-dsc-block-prediction-enable;
			};
		};
	};
};

/* from a23/a23_eur_open_w00_r08.dts */
&ss_dsi_panel_NT36672C_PM6585JB3_FHD {
	qcom,display-type = "primary";
	qcom,dsi-ctrl-num = <0>;
	qcom,dsi-phy-num = <0>;

	/delete-property/ qcom,panel-mode-gpio;


	samsung,ub-con-det = <SEC_GPIO_REF(AP,tlmm,19) 0>;

	samsung,esd-irq-gpio1 = <SEC_GPIO_REF(AP,tlmm,35) 0>; /* DISP_DET */


	qcom,panel-supply-entries
	{
		#address-cells = <1>;
		#size-cells = <0>;

		/* display on: 1.8V -> 1ms -> 5.5V & -5.5V on -> 10ms -> reset high -> LP11
		 * -> reset low -> 3ms -> reset high -> 10ms -> display config 1 cmds
		 * -> 10ms -> sleep in cmd -> 100ms -> display on cmd
		 */
		/* display off: 'FFh 10h' and 'FBh 01h' cmds -> display off cmd -> 20ms
		* -> sleep in -> lp11 -> 60ms -> reset low -> -5.5V  & 5.5V off-> 1ms ->  vddi off
		*/
		qcom,panel-supply-entry@0 {
			reg = <0>;
			qcom,supply-name = "lcd_vddi"; /* VDD 1.8V */
			qcom,supply-min-voltage = <1800000>;
			qcom,supply-max-voltage = <1800000>;
			qcom,supply-enable-load = <100000>;
			qcom,supply-disable-load = <100>;
			qcom,supply-pre-on-sleep = <0>; /* unit is ms*/
			qcom,supply-post-on-sleep = <1>;
			qcom,supply-post-off-sleep = <32>;
		};

		qcom,panel-supply-entry@1 {
			reg = <1>;
			qcom,supply-name = "lcd_vsp";
			qcom,supply-min-voltage = <1800000>;
			qcom,supply-max-voltage = <1800000>;
			qcom,supply-enable-load = <100000>;
			qcom,supply-disable-load = <100>;
			qcom,supply-pre-on-sleep = <0>; /* unit is ms*/
			qcom,supply-post-on-sleep = <2>;
			qcom,supply-post-off-sleep = <4>;
		};
		qcom,panel-supply-entry@2 {
			reg = <2>;
			qcom,supply-name = "lcd_vsn";
			qcom,supply-min-voltage = <1800000>;
			qcom,supply-max-voltage = <1800000>;
			qcom,supply-enable-load = <100000>;
			qcom,supply-disable-load = <100>;
			qcom,supply-pre-on-sleep = <0>; /* unit is ms*/
			qcom,supply-post-on-sleep = <13>;
			qcom,supply-post-off-sleep = <2>;
		};

		qcom,panel-supply-entry@4 {
			reg = <4>;
			qcom,supply-name = "lcd_rst";
			qcom,supply-min-voltage = <1800000>;
			qcom,supply-max-voltage = <1800000>;
			qcom,supply-enable-load = <100000>;
			qcom,supply-disable-load = <100>;
			qcom,supply-pre-on-sleep = <0>; /* unit is ms*/
			qcom,supply-post-on-sleep = <10>;
			qcom,supply-post-off-sleep = <1>;
		};
	};
};

/* from a23/a23_eur_open_w00_r08.dts */
/* #include "../../A23_ILI7807S_BS066FBM.dtsi" */    /* From A23_ILI7807S_BS066FBM.py */
/* Copyright (c) 2013-14, Samsung Electronics Corporation. All rights reserved.
 *
 * This program is free software; you can redistribute it and/or modify
 * it under the terms of the GNU General Public License version 2 and
 * only version 2 as published by the Free Software Foundation.
 *
 * This program is distributed in the hope that it will be useful,
 * but WITHOUT ANY WARRANTY; without even the implied warranty of
 * MERCHANTABILITY or FITNESS FOR A PARTICULAR PURPOSE.  See the
 * GNU General Public License for more details.
 */

/*---------------------------------------------------------------------------
 * This file is autogenerated file using gcdb parser. Please do not edit it.
 * Update input XML file to add a new entry or update variable in this file
 * VERSION = "1.0"
 *---------------------------------------------------------------------------*/
&mdss_mdp {
	A23_ILI7807S_BS066FBM: A23_ILI7807S_BS066FBM {
		qcom,mdss-dsi-panel-name = "A23_ILI7807S_BS066FBM";
		label = "A23_ILI7807S_BS066FBM";

		qcom,mdss-dsi-bpp = <24>;

		/*qcom,cmd-sync-wait-broadcast;*/

		qcom,mdss-dsi-h-left-border = <0>;
		qcom,mdss-dsi-h-right-border = <0>;
		qcom,mdss-dsi-v-top-border = <0>;
		qcom,mdss-dsi-v-bottom-border = <0>;

		qcom,mdss-dsi-panel-framerate = <60>;
		qcom,mdss-dsi-panel-phy-timings = [00 25 0A 0A 1B 24 0A 0A 0A 02 04 00 1F 0F];

		qcom,mdss-dsi-underflow-color = <0xFF>;
		qcom,mdss-dsi-border-color = <0>;

		qcom,mdss-dsi-bl-pmic-control-type = "bl_ctrl_dcs";

		qcom,mdss-dsi-bl-min-level = <1>;
		qcom,mdss-dsi-bl-max-level = <425>;
		qcom,mdss-brightness-max-level = <425>;
		qcom,mdss-brightness-default-level = <255>;
		qcom,mdss-dsi-interleave-mode = <0>;
		qcom,mdss-dsi-panel-type = "dsi_video_mode";

		/*qcom,dynamic-mode-switch-enabled;*/
		/*qcom,dynamic-mode-switch-type = "dynamic-resolution-switch-immediate";*/

		qcom,mdss-dsi-te-dcs-command = <1>;
		qcom,mdss-dsi-wr-mem-start = <0x2C>;
		qcom,mdss-dsi-wr-mem-continue = <0x3C>;

		qcom,mdss-dsi-pixel-packing = "loose";

		qcom,mdss-dsi-virtual-channel-id = <0>;
		qcom,mdss-dsi-color-order = "rgb_swap_rgb";
		qcom,mdss-dsi-lane-0-state;
		qcom,mdss-dsi-lane-1-state;
		qcom,mdss-dsi-lane-2-state;
		qcom,mdss-dsi-lane-3-state;
		//qcom,mdss-dsi-lane-map = "lane_map_0123";

		qcom,mdss-dsi-t-clk-pre = <0x1F>;
		qcom,mdss-dsi-t-clk-post = <0x0F>;

		qcom,mdss-dsi-bllp-eof-power-mode;
		qcom,mdss-dsi-bllp-power-mode;

		/*qcom,mdss-dsi-force-clock-lane-hs; to prevent esd, use non-continuous mode clock */

		qcom,mdss-dsi-stream = <0>;
		qcom,mdss-dsi-mdp-trigger = "none";
		qcom,mdss-dsi-dma-trigger = "trigger_sw";

		qcom,mdss-pan-physical-width-dimension = <68>;  /* 68.43, round-off */
		qcom,mdss-pan-physical-height-dimension = <152>; /* 152.57, round-off */

		qcom,mdss-dsi-reset-sequence = <1 1>, <0 1>, <1 1>;
		/*qcom,mdss-dsi-lp11-init; should turn on vddi before lp11 */
		/*qcom,mdss-dsi-init-delay-us = <1000>;*/

		qcom,mdss-dsi-rx-eot-ignore;
		qcom,mdss-dsi-tx-eot-append;

		qcom,bl-update-flag = "delay_until_first_frame";

		/* HDR Setting */
		qcom,mdss-dsi-panel-hdr-enabled;
		qcom,mdss-dsi-panel-hdr-color-primaries = <15635 16450 34000 16000 13250 34500 7500 3000>;
		qcom,mdss-dsi-panel-peak-brightness = <4000000>;
		qcom,mdss-dsi-panel-average-brightness = <1200000>;
		qcom,mdss-dsi-panel-blackness-level = <5>;

		qcom,suspend-ulps-enabled; /* enable ulps to prevent vddi floating by DDI's LP11 state */

		qcom,esd-check-enabled;
		samsung,esd-irq-trigger1 = "falling"; /* FG_ERR */
		qcom,mdss-dsi-panel-status-check-mode ="irq_check";

		/*qcom,mdss-dsi-panel-status-irq-trigger1 = "falling";*/
		/*qcom,mdss-dsi-panel-status-read-length;*/
		/*qcom,mdss-dsi-panel-status-value;*/
		/*qcom,mdss-dsi-panel-status-irq-trigger1 = "rising"; FG_ERR*/

		/* VRR for video mode */
		qcom,dsi-supported-dfps-list = <90 60>;
		qcom,mdss-dsi-pan-enable-dynamic-fps;
		qcom,mdss-dsi-pan-fps-update = "dfps_immediate_porch_mode_vfp";

		/* *************************************************************
		 * Below  parameters are samsung dependent thigs
		 * *************************************************************
		 */
		samsung,panel-vendor = "BOE";
		samsung,disp-model = "BS066FBM";
		samsung,esc-clk-128M;
		samsung,tft-common-support;
		//samsung,lp11_sleep_ms_time = <60>;
		samsung,support_factory_panel_swap;
		samsung,pll_ssc_disabled;
		//samsung,aot_enable;
		samsung,aot_reset_regulator_late;

		/* *************************************************************
		 *  Tx
		 * *************************************************************
		 */

		samsung,packet_size_tx_cmds_revA = [ 37 01 00 00 00 00 02 07 00 ];

		/* transmit sleep out and display on commands in
		 * qcom,mdss-dsi-on-command for display on sequence spec.
		 * op code spec: send sleep out and display on command before MIPI HS mode.
		 * samsung,display_on_tx_cmds_revA = "W 0x11
Delay 60ms
W 0x29";
		 */

		/* *************************************************************
		 *  Rx (Module Information READ)
		 * *************************************************************
		 */

		/* Change mipi type from 0x06 to 0x14 for normal mipi read response */
		/* PPS command in bootloader changes page mode.
		 * Reset page mode for mtp id rx
		 */
		samsung,manufacture_read_pre_tx_cmds_revA = "W 0xFF 0x78 0x07 0x00";

		samsung,manufacture_id0_rx_cmds_revA	= "R 0xDA 0x01";
		samsung,manufacture_id1_rx_cmds_revA	= "R 0xDB 0x01";
		samsung,manufacture_id2_rx_cmds_revA	= "R 0xDC 0x01";

		samsung,mtp_read_sysfs_rx_cmds_revA	= [06 01 00 00 00 00 01 00 00 00];
		samsung,mtp_write_sysfs_tx_cmds_revA	= [
			29 00 00 00 00 00 3D 00
						00 00 00 00 00 00 00 00 00 00
						00 00 00 00 00 00 00 00 00 00
						00 00 00 00 00 00 00 00 00 00
						00 00 00 00 00 00 00 00 00 00
						00 00 00 00 00 00 00 00 00 00
						00 00 00 00 00 00 00 00 00 00
		];

 		samsung,brightness_tx_cmds_revA = [
			39 01 00 00 00 00 03 51 07 F0 /* 00=off, 01=2/256, FF=256/256, 8 bits, use 11:4 bits  */
		];

		 /* 00=off, 01=2/256, FF=256/256, 8 bits */
		samsung,ss_brightness_tx_cmds_revA = "";


		/*
		 * ************************************************************************************************************************
		 * candela to index mappings
		 * ************************************************************************************************************************
		 */
		samsung,candela_map_table_revA = <
		/* THIS TABLE USED FOR SMART-DIMMING */
		/*<idx>   <from>  <till> <candella> */
			0	0	0	0
			1	1	1	1
			2	2	2	1
			3	3	3	2
			4	4	4	2
			5	5	5	3
			6	6	6	3
			7	7	7	4
			8	8	8	5
			9	9	9	5
			10	10	10	6
			11	11	11	6
			12	12	12	7
			13	13	13	7
			14	14	14	8
			15	15	15	8
			16	16	16	9
			17	17	17	10
			18	18	18	10
			19	19	19	11
			20	20	20	11
			21	21	21	12
			22	22	22	12
			23	23	23	13
			24	24	24	13
			25	25	25	14
			26	26	26	14
			27	27	27	15
			28	28	28	15
			29	29	29	16
			30	30	30	16
			31	31	31	17
			32	32	32	17
			33	33	33	18
			34	34	34	18
			35	35	35	19
			36	36	36	19
			37	37	37	19
			38	38	38	20
			39	39	39	20
			40	40	40	21
			41	41	41	21
			42	42	42	22
			43	43	43	22
			44	44	44	23
			45	45	45	23
			46	46	46	24
			47	47	47	24
			48	48	48	25
			49	49	49	25
			50	50	50	26
			51	51	51	26
			52	52	52	27
			53	53	53	28
			54	54	54	28
			55	55	55	29
			56	56	56	29
			57	57	57	30
			58	58	58	31
			59	59	59	31
			60	60	60	32
			61	61	61	32
			62	62	62	33
			63	63	63	33
			64	64	64	34
			65	65	65	34
			66	66	66	35
			67	67	67	35
			68	68	68	36
			69	69	69	37
			70	70	70	37
			71	71	71	38
			72	72	72	38
			73	73	73	39
			74	74	74	40
			75	75	75	41
			76	76	76	42
			77	77	77	43
			78	78	78	43
			79	79	79	44
			80	80	80	45
			81	81	81	45
			82	82	82	46
			83	83	83	47
			84	84	84	47
			85	85	85	48
			86	86	86	49
			87	87	87	49
			88	88	88	50
			89	89	89	51
			90	90	90	52
			91	91	91	53
			92	92	92	54
			93	93	93	55
			94	94	94	56
			95	95	95	57
			96	96	96	57
			97	97	97	58
			98	98	98	58
			99	99	99	59
			100	100	100	60
			101	101	101	60
			102	102	102	61
			103	103	103	61
			104	104	104	62
			105	105	105	62
			106	106	106	63
			107	107	107	63
			108	108	108	64
			109	109	109	64
			110	110	110	65
			111	111	111	65
			112	112	112	66
			113	113	113	66
			114	114	114	67
			115	115	115	67
			116	116	116	67
			117	117	117	68
			118	118	118	68
			119	119	119	69
			120	120	120	69
			121	121	121	70
			122	122	122	70
			123	123	123	71
			124	124	124	71
			125	125	125	72
			126	126	126	72
			127	127	127	73
			128	128	128	73
			129	129	129	74
			130	130	130	75
			131	131	131	76
			132	132	132	77
			133	133	133	78
			134	134	134	79
			135	135	135	80
			136	136	136	81
			137	137	137	82
			138	138	138	83
			139	139	139	84
			140	140	140	85
			141	141	141	86
			142	142	142	87
			143	143	143	88
			144	144	144	89
			145	145	145	90
			146	146	146	91
			147	147	147	92
			148	148	148	93
			149	149	149	94
			150	150	150	95
			151	151	151	96
			152	152	152	97
			153	153	153	98
			154	154	154	99
			155	155	155	100
			156	156	156	101
			157	157	157	102
			158	158	158	103
			159	159	159	104
			160	160	160	105
			161	161	161	106
			162	162	162	107
			163	163	163	108
			164	164	164	109
			165	165	165	110
			166	166	166	111
			167	167	167	112
			168	168	168	113
			169	169	169	114
			170	170	170	115
			171	171	171	116
			172	172	172	117
			173	173	173	118
			174	174	174	119
			175	175	175	119
			176	176	176	120
			177	177	177	121
			178	178	178	122
			179	179	179	123
			180	180	180	124
			181	181	181	125
			182	182	182	126
			183	183	183	127
			184	184	184	128
			185	185	185	129
			186	186	186	130
			187	187	187	131
			188	188	188	132
			189	189	189	133
			190	190	190	134
			191	191	191	135
			192	192	192	136
			193	193	193	137
			194	194	194	137
			195	195	195	138
			196	196	196	139
			197	197	197	140
			198	198	198	141
			199	199	199	142
			200	200	200	142
			201	201	201	143
			202	202	202	144
			203	203	203	145
			204	204	204	146
			205	205	205	147
			206	206	206	148
			207	207	207	148
			208	208	208	149
			209	209	209	150
			210	210	210	151
			211	211	211	152
			212	212	212	153
			213	213	213	153
			214	214	214	154
			215	215	215	155
			216	216	216	156
			217	217	217	157
			218	218	218	158
			219	219	219	159
			220	220	220	159
			221	221	221	160
			222	222	222	161
			223	223	223	162
			224	224	224	163
			225	225	225	164
			226	226	226	164
			227	227	227	165
			228	228	228	166
			229	229	229	167
			230	230	230	168
			231	231	231	169
			232	232	232	170
			233	233	233	170
			234	234	234	171
			235	235	235	172
			236	236	236	173
			237	237	237	174
			238	238	238	175
			239	239	239	175
			240	240	240	176
			241	241	241	177
			242	242	242	178
			243	243	243	179
			244	244	244	180
			245	245	245	181
			246	246	246	181
			247	247	247	182
			248	248	248	183
			249	249	249	184
			250	250	250	185
			251	251	251	186
			252	252	252	186
			253	253	253	187
			254	254	254	188
			255	255	255	189
			256	256	256	190
			257	257	257	190
			258	258	258	191
			259	259	259	192
			260	260	260	193
			261	261	261	193
			262	262	262	194
			263	263	263	195
			264	264	264	196
			265	265	265	196
			266	266	266	197
			267	267	267	198
			268	268	268	198
			269	269	269	199
			270	270	270	200
			271	271	271	201
			272	272	272	201
			273	273	273	202
			274	274	274	203
			275	275	275	204
			276	276	276	204
			277	277	277	205
			278	278	278	206
			279	279	279	206
			280	280	280	207
			281	281	281	208
			282	282	282	209
			283	283	283	209
			284	284	284	210
			285	285	285	211
			286	286	286	211
			287	287	287	212
			288	288	288	213
			289	289	289	214
			290	290	290	214
			291	291	291	215
			292	292	292	216
			293	293	293	217
			294	294	294	217
			295	295	295	218
			296	296	296	219
			297	297	297	219
			298	298	298	220
			299	299	299	221
			300	300	300	222
			301	301	301	222
			302	302	302	223
			303	303	303	224
			304	304	304	225
			305	305	305	225
			306	306	306	226
		>;

		samsung,support_ss_cmd;
		samsung,ss_cmd_dsc_long_write; /* 39h instead of 29h */
		/* samsung,ss_cmd_dsc_short_write_param;  15h instead of 05h */

		/*
		* ************************************************************************************************************************
		* MULTI_RESOLUTION (DSC configs were moved all to below timing set)
		* ************************************************************************************************************************
		*/

		/* transmit sleep out and display on commands in
		 * qcom,mdss-dsi-on-command for display on sequence spec.
		 * op code spec: send sleep out and display on command before MIPI HS mode.
		 */
		samsung,mdss_dsi_on_tx_cmds_revA = "W 0xFF 0x78 0x07 0x01
W 0x00 0x62
W 0x01 0x11
W 0x02 0x00
W 0x03 0x00
W 0x04 0x00
W 0x05 0x00
W 0x06 0x00
W 0x07 0x00
W 0x08 0xA9
W 0x09 0x0A
W 0x0A 0x30
W 0x0B 0x00
W 0x0C 0x00
W 0x0D 0x00
W 0x0E 0x00
W 0x31 0x07
W 0x32 0x02
W 0x33 0x41
W 0x34 0x41
W 0x35 0x28
W 0x36 0x28
W 0x37 0x30
W 0x38 0x2F
W 0x39 0x2E
W 0x3A 0x30
W 0x3B 0x2F
W 0x3C 0x2E
W 0x3D 0x25
W 0x3E 0x11
W 0x3F 0x10
W 0x40 0x13
W 0x41 0x12
W 0x42 0x2C
W 0x43 0x40
W 0x44 0x40
W 0x45 0x01
W 0x46 0x00
W 0x47 0x09
W 0x48 0x08
W 0x49 0x07
W 0x4A 0x02
W 0x4B 0x41
W 0x4C 0x41
W 0x4D 0x28
W 0x4E 0x28
W 0x4F 0x30
W 0x50 0x2F
W 0x51 0x2E
W 0x52 0x30
W 0x53 0x2F
W 0x54 0x2E
W 0x55 0x25
W 0x56 0x11
W 0x57 0x10
W 0x58 0x13
W 0x59 0x12
W 0x5A 0x2C
W 0x5B 0x40
W 0x5C 0x40
W 0x5D 0x01
W 0x5E 0x00
W 0x5F 0x09
W 0x60 0x08
W 0x61 0x07
W 0x62 0x02
W 0x63 0x41
W 0x64 0x41
W 0x65 0x28
W 0x66 0x28
W 0x67 0x30
W 0x68 0x2F
W 0x69 0x2E
W 0x6A 0x30
W 0x6B 0x2F
W 0x6C 0x2E
W 0x6D 0x25
W 0x6E 0x12
W 0x6F 0x13
W 0x70 0x10
W 0x71 0x11
W 0x72 0x2C
W 0x73 0x40
W 0x74 0x40
W 0x75 0x01
W 0x76 0x00
W 0x77 0x08
W 0x78 0x09
W 0x79 0x07
W 0x7A 0x02
W 0x7B 0x41
W 0x7C 0x41
W 0x7D 0x28
W 0x7E 0x28
W 0x7F 0x30
W 0x80 0x2F
W 0x81 0x2E
W 0x82 0x30
W 0x83 0x2F
W 0x84 0x2E
W 0x85 0x25
W 0x86 0x12
W 0x87 0x13
W 0x88 0x10
W 0x89 0x11
W 0x8A 0x2C
W 0x8B 0x40
W 0x8C 0x40
W 0x8D 0x01
W 0x8E 0x00
W 0x8F 0x08
W 0x90 0x09
W 0xA0 0x4C
W 0xA1 0x4A
W 0xA2 0x00
W 0xA3 0x00
W 0xA7 0x10
W 0xAA 0x00
W 0xAB 0x00
W 0xAC 0x00
W 0xAE 0x00
W 0xB0 0x20
W 0xB1 0x00
W 0xB2 0x01
W 0xB3 0x04
W 0xB4 0x05
W 0xB5 0x00
W 0xB6 0x00
W 0xB7 0x00
W 0xB8 0x00
W 0xC0 0x0C
W 0xC1 0x05
W 0xC2 0x00
W 0xC3 0x00
W 0xC4 0x00
W 0xC5 0x2B
W 0xC6 0x00
W 0xC7 0x28
W 0xC8 0x00
W 0xC9 0x00
W 0xCA 0x01
W 0xD0 0x01
W 0xD1 0x00
W 0xD2 0x10
W 0xD3 0x41
W 0xD4 0x89
W 0xD5 0x16
W 0xD6 0x49
W 0xD7 0x40
W 0xD8 0x09
W 0xD9 0x96
W 0xDA 0xAA
W 0xDB 0xAA
W 0xDC 0x8A
W 0xDD 0xA8
W 0xDE 0x05
W 0xDF 0x42
W 0xE0 0x1E
W 0xE1 0x68
W 0xE2 0x07
W 0xE3 0x11
W 0xE4 0x42
W 0xE5 0x4F
W 0xE6 0x24
W 0xE7 0x0C
W 0xE8 0x00
W 0xE9 0x00
W 0xEA 0x00
W 0xEB 0x00
W 0xEC 0x80
W 0xED 0x56
W 0xEE 0x00
W 0xEF 0x32
W 0xF0 0x00
W 0xF1 0xC0
W 0xF2 0xFF
W 0xF3 0xFF
W 0xF4 0x10
W 0xFF 0x78 0x07 0x03
W 0x80 0x36
W 0x83 0x60
W 0x84 0x00
W 0x88 0xE6
W 0x89 0xEE
W 0x8A 0xF6
W 0x8B 0xFE
W 0xAC 0xFE
W 0xC6 0x14
W 0xFF 0x78 0x07 0x11
W 0x38 0x00
W 0x39 0x04
W 0x50 0x15
W 0x51 0x05
W 0xFF 0x78 0x07 0x02
W 0x1B 0x01
W 0x46 0x21
W 0x47 0x03
W 0x4F 0x01
W 0x4C 0x00
W 0x5B 0x50
W 0xFF 0x78 0x07 0x12
W 0x48 0x04
W 0x49 0x00
W 0x4A 0x06
W 0x4B 0x20
W 0x4E 0x05
W 0x52 0x1F
W 0x53 0x25
W 0xC8 0x47
W 0xC9 0x00
W 0xCA 0x2C
W 0xCB 0x28
W 0xFF 0x78 0x07 0x04
W 0xBD 0x01
W 0xFF 0x78 0x07 0x05
W 0x72 0x56
W 0x74 0x56
W 0x76 0x51
W 0x7A 0x51
W 0x7B 0x7E
W 0x7C 0x7E
W 0x46 0x55
W 0x47 0x55
W 0xB5 0x55
W 0xB7 0x55
W 0xC6 0x1B
W 0x56 0xFF
W 0x3E 0x50
W 0xFF 0x78 0x07 0x06
W 0xC0 0x68
W 0xC1 0x19
W 0xC3 0x06
W 0x13 0x13
W 0xFF 0x78 0x07 0x07
W 0x29 0xCF
W 0xFF 0x78 0x07 0x17
W 0x20 0x00 0x00 0x00 0x00 0x00 0x11 0x00 0x00 0x89 0x30 0x80 0x09 0x68 0x04 0x38 0x00 0x08 0x02 0x1C 0x02 0x1C 0x00 0xAA 0x02 0x0E 0x00 0x20 0x00 0x2B 0x00 0x07 0x00 0x0C 0x0D 0xB7 0x0C 0xB7 0x18 0x00 0x1B 0xA0 0x03 0x0C 0x20 0x00 0x06 0x0B 0x0B 0x33 0x0E 0x1C 0x2A 0x38 0x46 0x54 0x62 0x69 0x70 0x77 0x79 0x7B 0x7D 0x7E 0x01 0x02 0x01 0x00 0x09 0x40 0x09 0xBE 0x19 0xFC 0x19 0xFA 0x19 0xF8 0x1A 0x38 0x1A 0x78 0x1A 0xB6 0x2A 0xF6 0x2B 0x34 0x2B 0x74 0x3B 0x74 0x6B 0xF4 0x00 0x00 0x00 0x00 0x00 0x00 0x00 0x00 0x00 0x00 0x00 0x00 0x00 0x00 0x00 0x00 0x00 0x00 0x00 0x00 0x00 0x00 0x00 0x00 0x00 0x00 0x00 0x00 0x00 0x00 0x00 0x00 0x00 0x00 0x00 0x00 0x00 0x00 0x00 0x00
W 0xFF 0x78 0x07 0x08
W 0xE0 0x00 0x00 0x16 0x41 0x00 0x7D 0xA9 0xC3 0x14 0xFD 0x2C 0x6E 0x25 0xA0 0xEA 0x27 0x2A 0x60 0xA0 0xC8 0x3E 0xFD 0x1F 0x4B 0x3F 0x66 0x89 0xB8 0x0F 0xD2 0xD7
W 0xE1 0x00 0x00 0x16 0x41 0x00 0x7D 0xA9 0xC3 0x14 0xFD 0x2C 0x6E 0x25 0xA0 0xEA 0x27 0x2A 0x60 0xA0 0xC8 0x3E 0xFD 0x1F 0x4B 0x3F 0x66 0x89 0xB8 0x0F 0xD2 0xD7
W 0xFF 0x78 0x07 0x0B
W 0xC6 0x85
W 0xC7 0x6C
W 0xC8 0x04
W 0xC9 0x04
W 0xCA 0x87
W 0xCB 0x87
W 0xD8 0x08
W 0xD9 0xEA
W 0xDA 0x06
W 0xDB 0x06
W 0xDC 0xDE
W 0xDD 0xDE
W 0xAA 0x12
W 0xAB 0xE0
W 0xFF 0x78 0x07 0x0C
W 0x40 0x3F
W 0x41 0x98
W 0x42 0x3F
W 0x43 0x9A
W 0x44 0x3F
W 0x45 0xA0
W 0x46 0x3F
W 0x47 0x96
W 0x48 0x3F
W 0x49 0x9C
W 0x4A 0x3F
W 0x4B 0x9E
W 0xFF 0x78 0x07 0x0E
W 0x00 0xA3
W 0x02 0x0F
W 0x04 0x06
W 0x0B 0x00
W 0x13 0x04
W 0xB0 0x21
W 0xC0 0x12
W 0x05 0x20
W 0xFF 0x78 0x07 0x1E
W 0x20 0x08
W 0x21 0x00
W 0x22 0x06
W 0x23 0x20
W 0x24 0x05
W 0xBD 0x01
W 0xB1 0x1F
W 0x61 0x1E
W 0x62 0x03
W 0x63 0x1E
W 0x64 0x83
W 0x60 0x07
W 0x65 0x0A
W 0x66 0xCF
W 0x67 0x10
W 0x69 0x2D
W 0x16 0x3E
W 0x1E 0x3E
W 0x1F 0x3E
W 0x6D 0x7A
W 0x70 0x00
W 0x6B 0x05
W 0xFF 0x78 0x07 0x00
W 0x53 0x2C
W 0x55 0x01
						    W 0x11
Delay 60ms
W 0x29";
		samsung,mdss_dsi_on_tx_cmds_revA_lp; /* Without this feature, whole ss commands be sent on HS mode */

		samsung,mdss_dsi_off_tx_cmds_revA = "W 0x28
Delay 20ms
W 0x10
Delay 80ms";

		qcom,mdss-dsi-display-timings {
			fhd {
				qcom,display-topology = <1 1 1>;
				qcom,default-topology-index = <0>;

				qcom,mdss-dsi-panel-width = <1080>;
				qcom,mdss-dsi-panel-height = <2408>;

				qcom,mdss-dsi-h-pulse-width = <60>;
				qcom,mdss-dsi-h-back-porch = <200>;
				qcom,mdss-dsi-h-front-porch = <210>;
				qcom,mdss-dsi-h-sync-skew = <0>;
				qcom,mdss-dsi-v-pulse-width = <4>;
				qcom,mdss-dsi-v-back-porch = <40>;
				qcom,mdss-dsi-v-front-porch = <40>;
				qcom,mdss-dsi-panel-clockrate = <1125000000>; /* 1125 Mbps*/

				qcom,mdss-dsi-panel-phy-timings = [00 25 0A 0A 1B 24 0A 0A 0A 02 04 00 1F 0F];

				qcom,mdss-dsi-t-clk-pre = <0x1F>;
				qcom,mdss-dsi-t-clk-post = <0x0F>;

				qcom,mdss-dsi-panel-framerate = <90>;
				/* qcom,mdss-mdp-transfer-time-us = <7533>; */

				/*qcom,mdss-dsi-timing-switch-command; use samsung,panel_multires_XXX instead*/
				/*qcom,mdss-dsi-timing-switch-command-state;*/

				qcom,mdss-dsi-on-command-state = "dsi_lp_mode";
				qcom,mdss-dsi-off-command-state = "dsi_hs_mode";

				qcom,compression-mode = "dsc";
				qcom,mdss-dsc-version = <0x11>;
				qcom,mdss-dsc-scr-version = <0>;
				qcom,mdss-dsc-slice-height = <8>;
				qcom,mdss-dsc-slice-width = <540>;
				qcom,mdss-dsc-slice-per-pkt = <1>;
				qcom,mdss-dsc-bit-per-component = <8>;
				qcom,mdss-dsc-bit-per-pixel = <8>;
				qcom,mdss-dsc-block-prediction-enable;
			};
		};
	};
};

/* from a23/a23_eur_open_w00_r08.dts */
&A23_ILI7807S_BS066FBM {
	qcom,display-type = "primary";
	qcom,dsi-ctrl-num = <0>;
	qcom,dsi-phy-num = <0>;

	/delete-property/ qcom,panel-mode-gpio;


	samsung,ub-con-det = <SEC_GPIO_REF(AP,tlmm,19) 0>;

	samsung,esd-irq-gpio1 = <SEC_GPIO_REF(AP,tlmm,35) 0>; /* DISP_DET */


	qcom,panel-supply-entries
	{
		#address-cells = <1>;
		#size-cells = <0>;

		/* display: 1.8V -> 1ms -> 5.5V -> 10ms -> reset high -> LP11
		 * -> reset low -> 3ms -> reset high -> 10ms -> command
		 */
		qcom,panel-supply-entry@0 {
			reg = <0>;
			qcom,supply-name = "lcd_vddi"; /* VDD 1.8V */
			qcom,supply-min-voltage = <1800000>;
			qcom,supply-max-voltage = <1800000>;
			qcom,supply-enable-load = <100000>;
			qcom,supply-disable-load = <100>;
			qcom,supply-pre-on-sleep = <0>; /* unit is ms*/
			qcom,supply-post-on-sleep = <2>; /* spec. is 1ms, but vddi raises slowly.. */
			qcom,supply-post-off-sleep = <32>;
		};

		qcom,panel-supply-entry@1 {
			reg = <1>;
			qcom,supply-name = "lcd_vsp";
			qcom,supply-min-voltage = <1800000>;
			qcom,supply-max-voltage = <1800000>;
			qcom,supply-enable-load = <100000>;
			qcom,supply-disable-load = <100>;
			qcom,supply-pre-on-sleep = <0>; /* unit is ms*/
			qcom,supply-post-on-sleep = <4>;
			qcom,supply-post-off-sleep = <4>;
		};
		qcom,panel-supply-entry@2 {
			reg = <2>;
			qcom,supply-name = "lcd_vsn";
			qcom,supply-min-voltage = <1800000>;
			qcom,supply-max-voltage = <1800000>;
			qcom,supply-enable-load = <100000>;
			qcom,supply-disable-load = <100>;
			qcom,supply-pre-on-sleep = <0>; /* unit is ms*/
			qcom,supply-post-on-sleep = <13>;
			qcom,supply-post-off-sleep = <2>;
		};

		qcom,panel-supply-entry@4 {
			reg = <4>;
			qcom,supply-name = "lcd_rst";
			qcom,supply-min-voltage = <1800000>;
			qcom,supply-max-voltage = <1800000>;
			qcom,supply-enable-load = <100000>;
			qcom,supply-disable-load = <100>;
			qcom,supply-pre-on-sleep = <0>; /* unit is ms*/
			qcom,supply-post-on-sleep = <10>;
			qcom,supply-post-off-sleep = <2>;
		};
	};
};

/* from a23/a23_eur_open_w00_r08.dts */
/* #include "../../A23_NT36672C_TCFJ6606.dtsi" */    /* From A23_NT36672C_TCFJ6606.py */
/* Copyright (c) 2021, Samsung Electronics Corporation. All rights reserved.
 *
 * This program is free software; you can redistribute it and/or modify
 * it under the terms of the GNU General Public License version 2 and
 * only version 2 as published by the Free Software Foundation.
 *
 * This program is distributed in the hope that it will be useful,
 * but WITHOUT ANY WARRANTY; without even the implied warranty of
 * MERCHANTABILITY or FITNESS FOR A PARTICULAR PURPOSE.  See the
 * GNU General Public License for more details.
 */

/*---------------------------------------------------------------------------
 * This file is autogenerated file using gcdb parser. Please do not edit it.
 * Update input XML file to add a new entry or update variable in this file
 * VERSION = "1.0"
 *---------------------------------------------------------------------------*/
&mdss_mdp {
	A23_NT36672C_TCFJ6606: A23_NT36672C_TCFJ6606 {
		qcom,mdss-dsi-panel-name = "A23_NT36672C_TCFJ6606";
		label = "A23_NT36672C_TCFJ6606";

		qcom,mdss-dsi-bpp = <24>;

		/*qcom,cmd-sync-wait-broadcast;*/

		qcom,mdss-dsi-h-left-border = <0>;
		qcom,mdss-dsi-h-right-border = <0>;
		qcom,mdss-dsi-v-top-border = <0>;
		qcom,mdss-dsi-v-bottom-border = <0>;

		qcom,mdss-dsi-underflow-color = <0xFF>;
		qcom,mdss-dsi-border-color = <0>;

		qcom,mdss-dsi-bl-pmic-control-type = "bl_ctrl_dcs";

		qcom,mdss-dsi-bl-min-level = <1>;
		qcom,mdss-dsi-bl-max-level = <425>;
		qcom,mdss-brightness-max-level = <425>;
		qcom,mdss-brightness-default-level = <255>;
		qcom,mdss-dsi-interleave-mode = <0>;
		qcom,mdss-dsi-panel-type = "dsi_video_mode";

		/*qcom,dynamic-mode-switch-enabled;*/
		/*qcom,dynamic-mode-switch-type = "dynamic-resolution-switch-immediate";*/

		qcom,mdss-dsi-te-dcs-command = <1>;
		qcom,mdss-dsi-wr-mem-start = <0x2C>;
		qcom,mdss-dsi-wr-mem-continue = <0x3C>;

		qcom,mdss-dsi-pixel-packing = "loose";

		qcom,mdss-dsi-virtual-channel-id = <0>;
		qcom,mdss-dsi-color-order = "rgb_swap_rgb";
		qcom,mdss-dsi-lane-0-state;
		qcom,mdss-dsi-lane-1-state;
		qcom,mdss-dsi-lane-2-state;
		qcom,mdss-dsi-lane-3-state;
		//qcom,mdss-dsi-lane-map = "lane_map_0123";

		qcom,mdss-dsi-t-clk-pre = <0x1F>;
		qcom,mdss-dsi-t-clk-post = <0x0F>;

		qcom,mdss-dsi-bllp-eof-power-mode;
		qcom,mdss-dsi-bllp-power-mode;

		/*qcom,mdss-dsi-force-clock-lane-hs; to prevent esd, use non-continuous mode clock */

		qcom,mdss-dsi-stream = <0>;
		qcom,mdss-dsi-mdp-trigger = "none";
		qcom,mdss-dsi-dma-trigger = "trigger_sw";

		qcom,mdss-pan-physical-width-dimension = <68>;  /* 68.43, round-off */
		qcom,mdss-pan-physical-height-dimension = <152>; /* 152.57, round-off */

		qcom,mdss-dsi-reset-sequence = <1 1>, <0 3>, <1 1>;
		/*qcom,mdss-dsi-lp11-init; should turn on vddi before lp11 */
		/*qcom,mdss-dsi-init-delay-us = <1000>;*/

		qcom,mdss-dsi-rx-eot-ignore;
		qcom,mdss-dsi-tx-eot-append;

		qcom,bl-update-flag = "delay_until_first_frame";

		/* HDR Setting */
		qcom,mdss-dsi-panel-hdr-enabled;
		qcom,mdss-dsi-panel-hdr-color-primaries = <15635 16450 34000 16000 13250 34500 7500 3000>;
		qcom,mdss-dsi-panel-peak-brightness = <4000000>;
		qcom,mdss-dsi-panel-average-brightness = <1200000>;
		qcom,mdss-dsi-panel-blackness-level = <5>;

		qcom,suspend-ulps-enabled; /* enable ulps to prevent vddi floating by DDI's LP11 state */

		qcom,esd-check-enabled;
		samsung,esd-irq-trigger1 = "falling"; /* FG_ERR */
		qcom,mdss-dsi-panel-status-check-mode ="irq_check";

		/*qcom,mdss-dsi-panel-status-irq-trigger1 = "falling";*/
		/*qcom,mdss-dsi-panel-status-read-length;*/
		/*qcom,mdss-dsi-panel-status-value;*/
		/*qcom,mdss-dsi-panel-status-irq-trigger1 = "rising"; FG_ERR*/

		/* VRR for video mode */
		qcom,dsi-supported-dfps-list = <90 60>;
		qcom,mdss-dsi-pan-enable-dynamic-fps;
		qcom,mdss-dsi-pan-fps-update = "dfps_immediate_porch_mode_vfp";

		/* *************************************************************
		 * Below  parameters are samsung dependent thigs
		 * *************************************************************
		 */
		samsung,panel-vendor = "CSO"; /* module for sharp panel is CSOT */
		samsung,disp-model = "TCFJ6606";
		samsung,esc-clk-128M;
		samsung,tft-common-support;
		//samsung,lp11_sleep_ms_time = <60>;
		samsung,support_factory_panel_swap;
		samsung,pll_ssc_disabled;
		//samsung,aot_enable;
		samsung,aot_reset_regulator_late;

		/* *************************************************************
		 *  Tx
		 * *************************************************************
		 */

		samsung,packet_size_tx_cmds_revA = [ 37 01 00 00 00 00 02 07 00 ];

		/* transmit sleep out and display on commands in
		 * qcom,mdss-dsi-on-command for display on sequence spec.
		 * op code spec: send sleep out and display on command before MIPI HS mode.
		 * samsung,display_on_tx_cmds_revA = "W 0x11
Delay 105ms
W 0x29";
		 */

		/* *************************************************************
		 *  Rx (Module Information READ)
		 * *************************************************************
		 */

		/* Change mipi type from 0x06 to 0x14 for normal mipi read response */
		samsung,manufacture_id0_rx_cmds_revA	= "R 0xDA 0x01";
		samsung,manufacture_id1_rx_cmds_revA	= "R 0xDB 0x01";
		samsung,manufacture_id2_rx_cmds_revA	= "R 0xDC 0x01";

		samsung,mtp_read_sysfs_rx_cmds_revA	= [06 01 00 00 00 00 01 00 00 00];
		samsung,mtp_write_sysfs_tx_cmds_revA	= [
			29 00 00 00 00 00 3D 00
						00 00 00 00 00 00 00 00 00 00
						00 00 00 00 00 00 00 00 00 00
						00 00 00 00 00 00 00 00 00 00
						00 00 00 00 00 00 00 00 00 00
						00 00 00 00 00 00 00 00 00 00
						00 00 00 00 00 00 00 00 00 00
		];

 		samsung,brightness_tx_cmds_revA = [
			39 01 00 00 00 00 02 51 7F /* 00=off, 01=2/256, FF=256/256, 8 bits */
		];

		 /* 00=off, 01=2/256, FF=256/256, 8 bits */
		samsung,ss_brightness_tx_cmds_revA = "";

		/*
		 * ************************************************************************************************************************
		 * candela to index mappings
		 * ************************************************************************************************************************
		 */
		samsung,candela_map_table_revA = <
		/* THIS TABLE USED FOR SMART-DIMMING */
		/*<idx>   <from>  <till> <candella> */
			0	0	0	0
			1	1	1	1
			2	2	2	1
			3	3	3	2
			4	4	4	2
			5	5	5	3
			6	6	6	3
			7	7	7	3
			8	8	8	4
			9	9	9	4
			10	10	10	5
			11	11	11	5
			12	12	12	6
			13	13	13	6
			14	14	14	7
			15	15	15	7
			16	16	16	8
			17	17	17	8
			18	18	18	9
			19	19	19	9
			20	20	20	10
			21	21	21	10
			22	22	22	11
			23	23	23	11
			24	24	24	12
			25	25	25	12
			26	26	26	13
			27	27	27	13
			28	28	28	14
			29	29	29	14
			30	30	30	15
			31	31	31	15
			32	32	32	16
			33	33	33	16
			34	34	34	17
			35	35	35	17
			36	36	36	18
			37	37	37	18
			38	38	38	19
			39	39	39	19
			40	40	40	20
			41	41	41	20
			42	42	42	20
			43	43	43	21
			44	44	44	21
			45	45	45	22
			46	46	46	22
			47	47	47	23
			48	48	48	23
			49	49	49	24
			50	50	50	24
			51	51	51	25
			52	52	52	25
			53	53	53	26
			54	54	54	26
			55	55	55	27
			56	56	56	27
			57	57	57	28
			58	58	58	28
			59	59	59	29
			60	60	60	29
			61	61	61	30
			62	62	62	30
			63	63	63	31
			64	64	64	32
			65	65	65	32
			66	66	66	33
			67	67	67	34
			68	68	68	34
			69	69	69	35
			70	70	70	35
			71	71	71	36
			72	72	72	37
			73	73	73	37
			74	74	74	38
			75	75	75	39
			76	76	76	39
			77	77	77	40
			78	78	78	41
			79	79	79	41
			80	80	80	42
			81	81	81	43
			82	82	82	43
			83	83	83	44
			84	84	84	45
			85	85	85	45
			86	86	86	46
			87	87	87	46
			88	88	88	47
			89	89	89	48
			90	90	90	48
			91	91	91	49
			92	92	92	50
			93	93	93	50
			94	94	94	51
			95	95	95	52
			96	96	96	52
			97	97	97	53
			98	98	98	54
			99	99	99	54
			100	100	100	55
			101	101	101	56
			102	102	102	56
			103	103	103	57
			104	104	104	57
			105	105	105	58
			106	106	106	59
			107	107	107	59
			108	108	108	60
			109	109	109	61
			110	110	110	61
			111	111	111	62
			112	112	112	63
			113	113	113	63
			114	114	114	64
			115	115	115	65
			116	116	116	65
			117	117	117	66
			118	118	118	67
			119	119	119	67
			120	120	120	68
			121	121	121	68
			122	122	122	69
			123	123	123	70
			124	124	124	70
			125	125	125	71
			126	126	126	72
			127	127	127	72
			128	128	128	73
			129	129	129	74
			130	130	130	75
			131	131	131	76
			132	132	132	77
			133	133	133	77
			134	134	134	78
			135	135	135	79
			136	136	136	80
			137	137	137	81
			138	138	138	82
			139	139	139	83
			140	140	140	84
			141	141	141	84
			142	142	142	85
			143	143	143	86
			144	144	144	87
			145	145	145	88
			146	146	146	89
			147	147	147	90
			148	148	148	91
			149	149	149	91
			150	150	150	92
			151	151	151	93
			152	152	152	94
			153	153	153	95
			154	154	154	96
			155	155	155	97
			156	156	156	98
			157	157	157	98
			158	158	158	99
			159	159	159	100
			160	160	160	101
			161	161	161	102
			162	162	162	103
			163	163	163	104
			164	164	164	105
			165	165	165	105
			166	166	166	106
			167	167	167	107
			168	168	168	108
			169	169	169	109
			170	170	170	110
			171	171	171	111
			172	172	172	112
			173	173	173	112
			174	174	174	113
			175	175	175	114
			176	176	176	115
			177	177	177	116
			178	178	178	117
			179	179	179	118
			180	180	180	119
			181	181	181	119
			182	182	182	120
			183	183	183	121
			184	184	184	122
			185	185	185	123
			186	186	186	124
			187	187	187	125
			188	188	188	126
			189	189	189	126
			190	190	190	127
			191	191	191	128
			192	192	192	129
			193	193	193	130
			194	194	194	131
			195	195	195	132
			196	196	196	133
			197	197	197	134
			198	198	198	135
			199	199	199	135
			200	200	200	136
			201	201	201	137
			202	202	202	138
			203	203	203	139
			204	204	204	140
			205	205	205	141
			206	206	206	142
			207	207	207	143
			208	208	208	144
			209	209	209	145
			210	210	210	146
			211	211	211	146
			212	212	212	147
			213	213	213	148
			214	214	214	149
			215	215	215	150
			216	216	216	151
			217	217	217	152
			218	218	218	153
			219	219	219	154
			220	220	220	155
			221	221	221	156
			222	222	222	157
			223	223	223	158
			224	224	224	158
			225	225	225	159
			226	226	226	160
			227	227	227	161
			228	228	228	162
			229	229	229	163
			230	230	230	164
			231	231	231	165
			232	232	232	166
			233	233	233	167
			234	234	234	168
			235	235	235	169
			236	236	236	170
			237	237	237	170
			238	238	238	171
			239	239	239	172
			240	240	240	173
			241	241	241	174
			242	242	242	175
			243	243	243	176
			244	244	244	177
			245	245	245	178
			246	246	246	179
			247	247	247	180
			248	248	248	181
			249	249	249	181
			250	250	250	182
			251	251	251	183
			252	252	252	184
			253	253	253	185
			254	254	254	186
			255	255	255	187
			256	256	256	188
			257	257	257	189
			258	258	258	189
			259	259	259	190
			260	260	260	191
			261	261	261	192
			262	262	262	192
			263	263	263	193
			264	264	264	194
			265	265	265	195
			266	266	266	195
			267	267	267	196
			268	268	268	197
			269	269	269	198
			270	270	270	198
			271	271	271	199
			272	272	272	200
			273	273	273	201
			274	274	274	202
			275	275	275	202
			276	276	276	203
			277	277	277	204
			278	278	278	205
			279	279	279	205
			280	280	280	206
			281	281	281	207
			282	282	282	208
			283	283	283	208
			284	284	284	209
			285	285	285	210
			286	286	286	211
			287	287	287	211
			288	288	288	212
			289	289	289	213
			290	290	290	214
			291	291	291	215
			292	292	292	215
			293	293	293	216
			294	294	294	217
			295	295	295	218
			296	296	296	218
			297	297	297	219
			298	298	298	220
			299	299	299	221
			300	300	300	221
			301	301	301	222
			302	302	302	223
			303	303	303	224
			304	304	304	224
			305	305	305	225
			306	306	306	226
		>;

		samsung,support_ss_cmd;
		samsung,ss_cmd_dsc_long_write; /* 39h instead of 29h */
		/* samsung,ss_cmd_dsc_short_write_param;  15h instead of 05h */

		/*
		* ************************************************************************************************************************
		* MULTI_RESOLUTION (DSC configs were moved all to below timing set)
		* ************************************************************************************************************************
		*/

		/* transmit sleep out and display on commands in
		 * qcom,mdss-dsi-on-command for display on sequence spec.
		 * op code spec: send sleep out and display on command before MIPI HS mode.
		 */
		samsung,mdss_dsi_on_tx_cmds_revA = "W 0xFF 0x10
W 0xFB 0x01
W 0xB0 0x01
W 0xC1 0x89 0x28 0x00 0x08 0x00 0xAA 0x02 0x0E 0x00 0x2B 0x00 0x07 0x0D 0xB7 0x0C 0xB7
W 0xC2 0x1B 0xA0
W 0xFF 0x20
W 0xFB 0x01
W 0x01 0x66
W 0x06 0x5B
W 0x07 0x27
W 0x17 0x66
W 0x1B 0x01
W 0x5C 0x90
W 0x5E 0xB0
W 0x69 0xD0
W 0x95 0xE5
W 0x96 0xE5
W 0xF2 0x66
W 0xF3 0x54
W 0xF4 0x66
W 0xF5 0x54
W 0xF6 0x66
W 0xF7 0x54
W 0xF8 0x66
W 0xF9 0x54
W 0xFF 0x21
W 0xFB 0x01
W 0xFF 0x23
W 0xFB 0x01
W 0x00 0x00
W 0x07 0x60
W 0x08 0x06
W 0x09 0x1C
W 0x0A 0x2B
W 0x0B 0x2B
W 0x0C 0x2B
W 0x0D 0x00
W 0x10 0x50
W 0x11 0x01
W 0x12 0x95
W 0x15 0x68
W 0x16 0x0B
W 0x19 0x00
W 0x1A 0x00
W 0x1B 0x00
W 0x1C 0x00
W 0x1D 0x01
W 0x1E 0x03
W 0x1F 0x05
W 0x20 0x0C
W 0x21 0x13
W 0x22 0x17
W 0x23 0x1D
W 0x24 0x23
W 0x25 0x2C
W 0x26 0x33
W 0x27 0x39
W 0x28 0x3F
W 0x29 0x3F
W 0x2A 0x3F
W 0x2B 0x3F
W 0x30 0xFF
W 0x31 0xFE
W 0x32 0xFD
W 0x33 0xFC
W 0x34 0xFB
W 0x35 0xFA
W 0x36 0xF9
W 0x37 0xF7
W 0x38 0xF5
W 0x39 0xF3
W 0x3A 0xF1
W 0x3B 0xEE
W 0x3D 0xEC
W 0x3F 0xEA
W 0x40 0xE8
W 0x41 0xE6
W 0x04 0x00
W 0xA0 0x11
W 0xFF 0x24
W 0xFB 0x01
W 0x00 0x11
W 0x07 0x18
W 0x08 0x16
W 0x09 0x14
W 0x0A 0x17
W 0x0B 0x15
W 0x0C 0x13
W 0x0D 0x0F
W 0x0E 0x2C
W 0x0F 0x32
W 0x10 0x30
W 0x11 0x2E
W 0x12 0x01
W 0x13 0x10
W 0x14 0x10
W 0x15 0x10
W 0x16 0x10
W 0x17 0x10
W 0x18 0x11
W 0x1F 0x18
W 0x20 0x16
W 0x21 0x14
W 0x22 0x17
W 0x23 0x15
W 0x24 0x13
W 0x25 0x0F
W 0x26 0x2D
W 0x27 0x33
W 0x28 0x31
W 0x29 0x2F
W 0x2A 0x01
W 0x2B 0x10
W 0x2D 0x10
W 0x2F 0x10
W 0x30 0x10
W 0x31 0x10
W 0x32 0x05
W 0x35 0x01
W 0x36 0x3E
W 0x4E 0x36
W 0x4F 0x36
W 0x53 0x36
W 0x7A 0x83
W 0x7B 0x0F
W 0x7C 0x00
W 0x7D 0x03
W 0x80 0x03
W 0x81 0x03
W 0x82 0x13
W 0x84 0x31
W 0x85 0x00
W 0x86 0x00
W 0x87 0x00
W 0x90 0x13
W 0x92 0x31
W 0x93 0x00
W 0x94 0x00
W 0x95 0x00
W 0x9C 0xF4
W 0x9D 0x01
W 0xA0 0x0F
W 0xA2 0x0F
W 0xA3 0x03
W 0xA4 0x03
W 0xA5 0x03
W 0xC4 0x80
W 0xC6 0xC0
W 0xC9 0x00
W 0xD9 0x80
W 0xE9 0x03
W 0xFF 0x25
W 0xFB 0x01
W 0x0F 0x1B
W 0x18 0x21
W 0x19 0xE4
W 0x20 0x03
W 0x21 0x40
W 0x68 0x58
W 0x69 0x10
W 0x6B 0x00
W 0x77 0x72
W 0x78 0x15
W 0x81 0x00
W 0x84 0x2D
W 0x86 0x0C
W 0x8E 0x10
W 0x8F 0x00
W 0xF1 0x40
W 0xFF 0x26
W 0xFB 0x01
W 0x14 0x06
W 0x15 0x01
W 0x74 0xAF
W 0x81 0x0F
W 0x83 0x03
W 0x84 0x02
W 0x85 0x01
W 0x86 0x02
W 0x87 0x01
W 0x88 0x07
W 0x8A 0x1A
W 0x8B 0x11
W 0x8C 0x24
W 0x8E 0x42
W 0x8F 0x11
W 0x90 0x11
W 0x91 0x11
W 0x9A 0x80
W 0x9B 0x04
W 0x9C 0x00
W 0x9D 0x00
W 0x9E 0x00
W 0xFF 0x27
W 0xFB 0x01
W 0x01 0x68
W 0x20 0x81
W 0x21 0x6F
W 0x25 0x81
W 0x26 0x97
W 0x3F 0x10
W 0x40 0x55
W 0x43 0x10
W 0x4E 0x05
W 0x6E 0x12
W 0x6F 0x00
W 0x70 0x00
W 0x71 0x00
W 0x72 0x00
W 0x73 0x76
W 0x74 0x10
W 0x75 0x32
W 0x76 0x54
W 0x77 0x00
W 0x7D 0x09
W 0x7E 0x6D
W 0x80 0x27
W 0x82 0x09
W 0x83 0x6D
W 0x88 0x01
W 0x89 0x01
W 0xE3 0x01
W 0xE4 0xE9
W 0xE5 0x02
W 0xE6 0xDE
W 0xE9 0x02
W 0xEA 0x1E
W 0xEB 0x03
W 0xEC 0x2D
W 0xFF 0x2A
W 0xFB 0x01
W 0x00 0x91
W 0x03 0x20
W 0x07 0x64
W 0x0A 0x70
W 0x0C 0x04
W 0x0D 0x40
W 0x0F 0x01
W 0x11 0xE1
W 0x15 0x0F
W 0x16 0xBE
W 0x19 0x0F
W 0x1A 0x92
W 0x1B 0x12
W 0x1D 0x36
W 0x1E 0x3F
W 0x1F 0x3F
W 0x20 0x3F
W 0x27 0x00
W 0x28 0xFD
W 0x29 0x0B
W 0x2A 0x42
W 0x2F 0x01
W 0x30 0x85
W 0x31 0xB4
W 0x34 0xFF
W 0x35 0x3F
W 0x36 0x05
W 0x37 0xF9
W 0x38 0x44
W 0x39 0x00
W 0x3A 0x85
W 0x45 0x04
W 0x46 0x40
W 0x48 0x01
W 0x4A 0xE1
W 0x4E 0x0F
W 0x4F 0xBE
W 0x52 0x0F
W 0x53 0x92
W 0x54 0x12
W 0x56 0x36
W 0x57 0x57
W 0x58 0x57
W 0x59 0x57
W 0x60 0x00
W 0x61 0xFD
W 0x62 0x05
W 0x63 0x79
W 0x66 0x01
W 0x67 0x43
W 0x68 0xC9
W 0x6B 0xFF
W 0x6C 0x2E
W 0x6D 0xA4
W 0x6E 0xFB
W 0x6F 0x31
W 0x70 0xA1
W 0x71 0x43
W 0x7A 0x09
W 0x7B 0x40
W 0x7F 0xF0
W 0x83 0x0F
W 0x84 0xBE
W 0x87 0x0F
W 0x88 0x92
W 0x89 0x12
W 0x8B 0x36
W 0x8C 0x7E
W 0x8D 0x7E
W 0x8E 0x7E
W 0xFF 0x2C
W 0xFB 0x01
W 0x00 0x03
W 0x01 0x03
W 0x02 0x03
W 0x03 0x15
W 0x04 0x15
W 0x05 0x15
W 0x0D 0x01
W 0x0E 0x55
W 0x17 0x49
W 0x18 0x49
W 0x19 0x49
W 0x2D 0xAF
W 0x4D 0x15
W 0x4E 0x03
W 0x4F 0x0D
W 0x53 0x03
W 0x54 0x03
W 0x55 0x03
W 0x61 0x01
W 0x62 0x7D
W 0x6B 0x69
W 0x6C 0x69
W 0x6D 0x69
W 0x80 0xAF
W 0x9D 0x1E
W 0x9E 0x03
W 0x9F 0x19
W 0xFF 0xE0
W 0xFB 0x01
W 0x35 0x82
W 0xFF 0xF0
W 0xFB 0x01
W 0x1C 0x01
W 0x33 0x01
W 0x5A 0x00
W 0xFF 0xD0
W 0xFB 0x01
W 0x53 0x22
W 0x54 0x02
W 0xFF 0xC0
W 0xFB 0x01
W 0x9C 0x11
W 0x9D 0x11
W 0xFF 0x2B
W 0xFB 0x01
W 0xB7 0x1C
W 0xB8 0x10
W 0xC0 0x01
W 0xFF 0x10
W 0xFB 0x01
W 0xC0 0x03
W 0x35 0x00
W 0xFF 0x10
W 0xFB 0x01
W 0x53 0x2C
W 0x55 0x01
W 0x68 0x00 0x01
						    W 0x11
Delay 105ms
W 0x29";
		samsung,mdss_dsi_on_tx_cmds_revA_lp; /* Without this feature, whole ss commands be sent on HS mode */

		samsung,mdss_dsi_off_tx_cmds_revA = "W 0x28
Delay 20ms
W 0x10
Delay 60ms
";

		qcom,mdss-dsi-display-timings {
			fhd {
				qcom,display-topology = <1 1 1>;
				qcom,default-topology-index = <0>;

				qcom,mdss-dsi-panel-width = <1080>;
				qcom,mdss-dsi-panel-height = <2408>;

				qcom,mdss-dsi-h-pulse-width = <8>;
				qcom,mdss-dsi-h-back-porch = <20>;
				qcom,mdss-dsi-h-front-porch = <452>;
				qcom,mdss-dsi-h-sync-skew = <0>;
				qcom,mdss-dsi-v-pulse-width = <8>;
				qcom,mdss-dsi-v-back-porch = <10>;
				qcom,mdss-dsi-v-front-porch = <54>; /* 54 for 90hz, 1294 for 60hz*/
				qcom,mdss-dsi-panel-clockrate = <1125000000>; /* 1125 Mbps*/
				qcom,mdss-dsi-panel-phy-timings = [00 25 0A 0A 1B 24 0A 0A 0A 02 04 00 1F 0F];
				qcom,mdss-dsi-t-clk-pre = <0x1F>;
				qcom,mdss-dsi-t-clk-post = <0x0F>;

				qcom,mdss-dsi-panel-framerate = <90>;
				/* qcom,mdss-mdp-transfer-time-us = <7533>; */

				/*qcom,mdss-dsi-timing-switch-command; use samsung,panel_multires_XXX instead*/
				/*qcom,mdss-dsi-timing-switch-command-state;*/

				qcom,mdss-dsi-on-command-state = "dsi_lp_mode";
				qcom,mdss-dsi-off-command-state = "dsi_hs_mode";

				qcom,compression-mode = "dsc";
				qcom,mdss-dsc-version = <0x11>;
				qcom,mdss-dsc-scr-version = <0>;
				qcom,mdss-dsc-slice-height = <8>;
				qcom,mdss-dsc-slice-width = <540>;
				qcom,mdss-dsc-slice-per-pkt = <1>;
				qcom,mdss-dsc-bit-per-component = <8>;
				qcom,mdss-dsc-bit-per-pixel = <8>;
				qcom,mdss-dsc-block-prediction-enable;
			};
		};
	};
};

/* from a23/a23_eur_open_w00_r08.dts */
&A23_NT36672C_TCFJ6606 {
	qcom,display-type = "primary";
	qcom,dsi-ctrl-num = <0>;
	qcom,dsi-phy-num = <0>;

	/delete-property/ qcom,panel-mode-gpio;


	samsung,ub-con-det = <SEC_GPIO_REF(AP,tlmm,19) 0>;

	samsung,esd-irq-gpio1 = <SEC_GPIO_REF(AP,tlmm,35) 0>; /* DISP_DET */


	qcom,panel-supply-entries
	{
		#address-cells = <1>;
		#size-cells = <0>;

		/* display on: 1.8V -> 1ms -> 5.5V & -5.5V on -> 10ms -> reset high -> LP11
		 * -> reset low -> 3ms -> reset high -> 10ms -> display config 1 cmds
		 * -> 10ms -> sleep in cmd -> 100ms -> display on cmd
		 */
		/* display off: 'FFh 10h' and 'FBh 01h' cmds -> display off cmd -> 20ms
		* -> sleep in -> lp11 -> 60ms -> reset low -> -5.5V  & 5.5V off-> 1ms ->  vddi off
		*/
		qcom,panel-supply-entry@0 {
			reg = <0>;
			qcom,supply-name = "lcd_vddi"; /* VDD 1.8V */
			qcom,supply-min-voltage = <1800000>;
			qcom,supply-max-voltage = <1800000>;
			qcom,supply-enable-load = <100000>;
			qcom,supply-disable-load = <100>;
			qcom,supply-pre-on-sleep = <0>; /* unit is ms*/
			qcom,supply-post-on-sleep = <1>;
			qcom,supply-post-off-sleep = <32>;
		};

		qcom,panel-supply-entry@1 {
			reg = <1>;
			qcom,supply-name = "lcd_vsp";
			qcom,supply-min-voltage = <1800000>;
			qcom,supply-max-voltage = <1800000>;
			qcom,supply-enable-load = <100000>;
			qcom,supply-disable-load = <100>;
			qcom,supply-pre-on-sleep = <0>; /* unit is ms*/
			qcom,supply-post-on-sleep = <2>;
			qcom,supply-post-off-sleep = <4>;
		};
		qcom,panel-supply-entry@2 {
			reg = <2>;
			qcom,supply-name = "lcd_vsn";
			qcom,supply-min-voltage = <1800000>;
			qcom,supply-max-voltage = <1800000>;
			qcom,supply-enable-load = <100000>;
			qcom,supply-disable-load = <100>;
			qcom,supply-pre-on-sleep = <0>; /* unit is ms*/
			qcom,supply-post-on-sleep = <13>;
			qcom,supply-post-off-sleep = <2>;
		};

		qcom,panel-supply-entry@4 {
			reg = <4>;
			qcom,supply-name = "lcd_rst";
			qcom,supply-min-voltage = <1800000>;
			qcom,supply-max-voltage = <1800000>;
			qcom,supply-enable-load = <100000>;
			qcom,supply-disable-load = <100>;
			qcom,supply-pre-on-sleep = <0>; /* unit is ms*/
			qcom,supply-post-on-sleep = <10>;
			qcom,supply-post-off-sleep = <1>;
		};
	};
};

/* from a23/a23_eur_open_w00_r08.dts */
/* #include "../../A23_FT8720_LPS066A767A.dtsi" */   /* From A23_FT8720_LPS066A767A.py */
/* Copyright (c) 2021, Samsung Electronics Corporation. All rights reserved.
 *
 * This program is free software; you can redistribute it and/or modify
 * it under the terms of the GNU General Public License version 2 and
 * only version 2 as published by the Free Software Foundation.
 *
 * This program is distributed in the hope that it will be useful,
 * but WITHOUT ANY WARRANTY; without even the implied warranty of
 * MERCHANTABILITY or FITNESS FOR A PARTICULAR PURPOSE.  See the
 * GNU General Public License for more details.
 */

/*---------------------------------------------------------------------------
 * This file is autogenerated file using gcdb parser. Please do not edit it.
 * Update input XML file to add a new entry or update variable in this file
 * VERSION = "1.0"
 *---------------------------------------------------------------------------*/
&mdss_mdp {
	A23_FT8720_LPS066A767A: A23_FT8720_LPS066A767A {
		qcom,mdss-dsi-panel-name = "A23_FT8720_LPS066A767A";
		label = "A23_FT8720_LPS066A767A";

		qcom,mdss-dsi-bpp = <24>;

		/*qcom,cmd-sync-wait-broadcast;*/

		qcom,mdss-dsi-h-left-border = <0>;
		qcom,mdss-dsi-h-right-border = <0>;
		qcom,mdss-dsi-v-top-border = <0>;
		qcom,mdss-dsi-v-bottom-border = <0>;

		qcom,mdss-dsi-underflow-color = <0xFF>;
		qcom,mdss-dsi-border-color = <0>;

		qcom,mdss-dsi-bl-pmic-control-type = "bl_ctrl_dcs";

		qcom,mdss-dsi-bl-min-level = <1>;
		qcom,mdss-dsi-bl-max-level = <425>;
		qcom,mdss-brightness-max-level = <425>;
		qcom,mdss-brightness-default-level = <255>;
		qcom,mdss-dsi-interleave-mode = <0>;
		qcom,mdss-dsi-panel-type = "dsi_video_mode";

		/*qcom,dynamic-mode-switch-enabled;*/
		/*qcom,dynamic-mode-switch-type = "dynamic-resolution-switch-immediate";*/

		qcom,mdss-dsi-te-dcs-command = <1>;
		qcom,mdss-dsi-wr-mem-start = <0x2C>;
		qcom,mdss-dsi-wr-mem-continue = <0x3C>;

		qcom,mdss-dsi-pixel-packing = "loose";

		qcom,mdss-dsi-virtual-channel-id = <0>;
		qcom,mdss-dsi-color-order = "rgb_swap_rgb";
		qcom,mdss-dsi-lane-0-state;
		qcom,mdss-dsi-lane-1-state;
		qcom,mdss-dsi-lane-2-state;
		qcom,mdss-dsi-lane-3-state;
		//qcom,mdss-dsi-lane-map = "lane_map_0123";

		qcom,mdss-dsi-t-clk-pre = <0x1F>;
		qcom,mdss-dsi-t-clk-post = <0x0F>;

		qcom,mdss-dsi-bllp-eof-power-mode;
		qcom,mdss-dsi-bllp-power-mode;

		/*qcom,mdss-dsi-force-clock-lane-hs; to prevent esd, use non-continuous mode clock */

		qcom,mdss-dsi-stream = <0>;
		qcom,mdss-dsi-mdp-trigger = "none";
		qcom,mdss-dsi-dma-trigger = "trigger_sw";

		qcom,mdss-pan-physical-width-dimension = <68>;  /* 68.43, round-off */
		qcom,mdss-pan-physical-height-dimension = <152>; /* 152.57, round-off */

		qcom,mdss-dsi-reset-sequence = <1 3>, <0 1>, <1 1>;
		/*qcom,mdss-dsi-lp11-init; should turn on vddi before lp11 */
		/*qcom,mdss-dsi-init-delay-us = <1000>;*/

		qcom,mdss-dsi-rx-eot-ignore;
		qcom,mdss-dsi-tx-eot-append;

		qcom,bl-update-flag = "delay_until_first_frame";

		/* HDR Setting */
		qcom,mdss-dsi-panel-hdr-enabled;
		qcom,mdss-dsi-panel-hdr-color-primaries = <15635 16450 34000 16000 13250 34500 7500 3000>;
		qcom,mdss-dsi-panel-peak-brightness = <4000000>;
		qcom,mdss-dsi-panel-average-brightness = <1200000>;
		qcom,mdss-dsi-panel-blackness-level = <5>;

		qcom,suspend-ulps-enabled; /* enable ulps to prevent vddi floating by DDI's LP11 state */

		qcom,esd-check-enabled;
		samsung,esd-irq-trigger1 = "falling"; /* FG_ERR */
		qcom,mdss-dsi-panel-status-check-mode ="irq_check";

		/*qcom,mdss-dsi-panel-status-irq-trigger1 = "falling";*/
		/*qcom,mdss-dsi-panel-status-read-length;*/
		/*qcom,mdss-dsi-panel-status-value;*/
		/*qcom,mdss-dsi-panel-status-irq-trigger1 = "rising"; FG_ERR*/

		/* VRR for video mode */
		qcom,dsi-supported-dfps-list = <90 60>;
		qcom,mdss-dsi-pan-enable-dynamic-fps;
		qcom,mdss-dsi-pan-fps-update = "dfps_immediate_porch_mode_vfp";

		/* *************************************************************
		 * Below  parameters are samsung dependent thigs
		 * *************************************************************
		 */
		samsung,panel-vendor = "DTC";
		samsung,disp-model = "LPS066A767A";
		samsung,esc-clk-128M;
		samsung,tft-common-support;
		//samsung,lp11_sleep_ms_time = <60>;
		samsung,support_factory_panel_swap;
		samsung,pll_ssc_disabled;
		//samsung,aot_enable;
		samsung,aot_reset_regulator_late;

		/* *************************************************************
		 *  Tx
		 * *************************************************************
		 */

		samsung,packet_size_tx_cmds_revA = [ 37 01 00 00 00 00 02 07 00 ];

		/* transmit sleep out and display on commands in
		 * qcom,mdss-dsi-on-command for display on sequence spec.
		 * op code spec: send sleep out and display on command before MIPI HS mode.
		 * samsung,display_on_tx_cmds_revA = "W 0x11
Delay 120ms
W 0x29";
		 */

		/* *************************************************************
		 *  Rx (Module Information READ)
		 * *************************************************************
		 */

		/* Change mipi type from 0x06 to 0x14 for normal mipi read response */
		samsung,manufacture_id0_rx_cmds_revA	= "R 0xDA 0x01";
		samsung,manufacture_id1_rx_cmds_revA	= "R 0xDB 0x01";
		samsung,manufacture_id2_rx_cmds_revA	= "R 0xDC 0x01";

		samsung,mtp_read_sysfs_rx_cmds_revA	= [06 01 00 00 00 00 01 00 00 00];
		samsung,mtp_write_sysfs_tx_cmds_revA	= [
			29 00 00 00 00 00 3D 00
						00 00 00 00 00 00 00 00 00 00
						00 00 00 00 00 00 00 00 00 00
						00 00 00 00 00 00 00 00 00 00
						00 00 00 00 00 00 00 00 00 00
						00 00 00 00 00 00 00 00 00 00
						00 00 00 00 00 00 00 00 00 00
		];

 		samsung,brightness_tx_cmds_revA = [
			39 01 00 00 00 00 02 51 7F /* 00=off, 01=2/256, FF=256/256, 8 bits */
		];

		/*
		 * ************************************************************************************************************************
		 * candela to index mappings
		 * ************************************************************************************************************************
		 */
		samsung,candela_map_table_revA = <
		/* THIS TABLE USED FOR SMART-DIMMING */
		/*<idx>   <from>  <till> <candella> */
			0	0	0	0
			1	1	1	1
			2	2	2	1
			3	3	3	2
			4	4	4	2
			5	5	5	3
			6	6	6	3
			7	7	7	4
			8	8	8	5
			9	9	9	5
			10	10	10	6
			11	11	11	6
			12	12	12	7
			13	13	13	7
			14	14	14	8
			15	15	15	8
			16	16	16	9
			17	17	17	10
			18	18	18	10
			19	19	19	11
			20	20	20	11
			21	21	21	12
			22	22	22	12
			23	23	23	13
			24	24	24	13
			25	25	25	14
			26	26	26	14
			27	27	27	15
			28	28	28	15
			29	29	29	16
			30	30	30	16
			31	31	31	17
			32	32	32	17
			33	33	33	18
			34	34	34	18
			35	35	35	19
			36	36	36	19
			37	37	37	19
			38	38	38	20
			39	39	39	20
			40	40	40	21
			41	41	41	21
			42	42	42	22
			43	43	43	22
			44	44	44	23
			45	45	45	23
			46	46	46	24
			47	47	47	24
			48	48	48	25
			49	49	49	25
			50	50	50	26
			51	51	51	26
			52	52	52	27
			53	53	53	28
			54	54	54	28
			55	55	55	29
			56	56	56	29
			57	57	57	30
			58	58	58	31
			59	59	59	31
			60	60	60	32
			61	61	61	32
			62	62	62	33
			63	63	63	33
			64	64	64	34
			65	65	65	34
			66	66	66	35
			67	67	67	35
			68	68	68	36
			69	69	69	37
			70	70	70	37
			71	71	71	38
			72	72	72	38
			73	73	73	39
			74	74	74	40
			75	75	75	41
			76	76	76	42
			77	77	77	43
			78	78	78	43
			79	79	79	44
			80	80	80	45
			81	81	81	45
			82	82	82	46
			83	83	83	47
			84	84	84	47
			85	85	85	48
			86	86	86	49
			87	87	87	49
			88	88	88	50
			89	89	89	51
			90	90	90	52
			91	91	91	53
			92	92	92	54
			93	93	93	55
			94	94	94	56
			95	95	95	57
			96	96	96	57
			97	97	97	58
			98	98	98	58
			99	99	99	59
			100	100	100	60
			101	101	101	60
			102	102	102	61
			103	103	103	61
			104	104	104	62
			105	105	105	62
			106	106	106	63
			107	107	107	63
			108	108	108	64
			109	109	109	64
			110	110	110	65
			111	111	111	65
			112	112	112	66
			113	113	113	66
			114	114	114	67
			115	115	115	67
			116	116	116	67
			117	117	117	68
			118	118	118	68
			119	119	119	69
			120	120	120	69
			121	121	121	70
			122	122	122	70
			123	123	123	71
			124	124	124	71
			125	125	125	72
			126	126	126	72
			127	127	127	73
			128	128	128	73
			129	129	129	74
			130	130	130	75
			131	131	131	76
			132	132	132	77
			133	133	133	78
			134	134	134	79
			135	135	135	80
			136	136	136	81
			137	137	137	82
			138	138	138	83
			139	139	139	84
			140	140	140	85
			141	141	141	86
			142	142	142	87
			143	143	143	88
			144	144	144	89
			145	145	145	90
			146	146	146	91
			147	147	147	92
			148	148	148	93
			149	149	149	94
			150	150	150	95
			151	151	151	96
			152	152	152	97
			153	153	153	98
			154	154	154	99
			155	155	155	100
			156	156	156	101
			157	157	157	102
			158	158	158	103
			159	159	159	104
			160	160	160	105
			161	161	161	106
			162	162	162	107
			163	163	163	108
			164	164	164	109
			165	165	165	110
			166	166	166	111
			167	167	167	112
			168	168	168	113
			169	169	169	114
			170	170	170	115
			171	171	171	116
			172	172	172	117
			173	173	173	118
			174	174	174	119
			175	175	175	119
			176	176	176	120
			177	177	177	121
			178	178	178	122
			179	179	179	123
			180	180	180	124
			181	181	181	125
			182	182	182	126
			183	183	183	127
			184	184	184	128
			185	185	185	129
			186	186	186	130
			187	187	187	131
			188	188	188	132
			189	189	189	133
			190	190	190	134
			191	191	191	135
			192	192	192	136
			193	193	193	137
			194	194	194	137
			195	195	195	138
			196	196	196	139
			197	197	197	140
			198	198	198	141
			199	199	199	142
			200	200	200	142
			201	201	201	143
			202	202	202	144
			203	203	203	145
			204	204	204	146
			205	205	205	147
			206	206	206	148
			207	207	207	148
			208	208	208	149
			209	209	209	150
			210	210	210	151
			211	211	211	152
			212	212	212	153
			213	213	213	153
			214	214	214	154
			215	215	215	155
			216	216	216	156
			217	217	217	157
			218	218	218	158
			219	219	219	159
			220	220	220	159
			221	221	221	160
			222	222	222	161
			223	223	223	162
			224	224	224	163
			225	225	225	164
			226	226	226	164
			227	227	227	165
			228	228	228	166
			229	229	229	167
			230	230	230	168
			231	231	231	169
			232	232	232	170
			233	233	233	170
			234	234	234	171
			235	235	235	172
			236	236	236	173
			237	237	237	174
			238	238	238	175
			239	239	239	175
			240	240	240	176
			241	241	241	177
			242	242	242	178
			243	243	243	179
			244	244	244	180
			245	245	245	181
			246	246	246	181
			247	247	247	182
			248	248	248	183
			249	249	249	184
			250	250	250	185
			251	251	251	186
			252	252	252	186
			253	253	253	187
			254	254	254	188
			255	255	255	189
			256	256	256	190
			257	257	257	190
			258	258	258	191
			259	259	259	192
			260	260	260	193
			261	261	261	193
			262	262	262	194
			263	263	263	195
			264	264	264	196
			265	265	265	196
			266	266	266	197
			267	267	267	198
			268	268	268	198
			269	269	269	199
			270	270	270	200
			271	271	271	201
			272	272	272	201
			273	273	273	202
			274	274	274	203
			275	275	275	204
			276	276	276	204
			277	277	277	205
			278	278	278	206
			279	279	279	206
			280	280	280	207
			281	281	281	208
			282	282	282	209
			283	283	283	209
			284	284	284	210
			285	285	285	211
			286	286	286	211
			287	287	287	212
			288	288	288	213
			289	289	289	214
			290	290	290	214
			291	291	291	215
			292	292	292	216
			293	293	293	217
			294	294	294	217
			295	295	295	218
			296	296	296	219
			297	297	297	219
			298	298	298	220
			299	299	299	221
			300	300	300	222
			301	301	301	222
			302	302	302	223
			303	303	303	224
			304	304	304	225
			305	305	305	225
			306	306	306	226
		>;

		samsung,support_ss_cmd;
		samsung,ss_cmd_dsc_long_write; /* 39h instead of 29h */
		/* samsung,ss_cmd_dsc_short_write_param;  15h instead of 05h */
		samsung,ss_cmd_always_last_command_set;

		/*
		* ************************************************************************************************************************
		* MULTI_RESOLUTION (DSC configs were moved all to below timing set)
		* ************************************************************************************************************************
		*/

		/* transmit sleep out and display on commands in
		 * qcom,mdss-dsi-on-command for display on sequence spec.
		 * op code spec: send sleep out and display on command before MIPI HS mode.
		 */
		samsung,mdss_dsi_on_tx_cmds_revA = "W 0x00 0x00
W 0xFF 0x87 0x20 0x01
W 0x00 0x80
W 0xFF 0x87 0x20
W 0x00 0x00
W 0x2A 0x00 0x00 0x04 0x37
W 0x00 0x00
W 0x2B 0x00 0x00 0x09 0x67
W 0x00 0xA3
W 0xB3 0x09 0x68 0x00 0x18
W 0x00 0x60
W 0xC0 0x00 0x9E 0x00 0x31 0x00 0x11
W 0x00 0x70
W 0xC0 0x00 0xC8 0x00 0xC8 0x0D 0x02 0xB6
W 0x00 0x79
W 0xC0 0x15 0x00 0xF1
W 0x00 0x80
W 0xC0 0x00 0x61 0x00 0x31 0x00 0x11
W 0x00 0x90
W 0xC0 0x00 0x61 0x00 0x31 0x00 0x11
W 0x00 0xA0
W 0xC0 0x00 0x92 0x00 0x31 0x00 0x11
W 0x00 0xB0
W 0xC0 0x00 0x93 0x00 0x31 0x11
W 0x00 0xA3
W 0xC1 0x00 0x46 0x00 0x28 0x00 0x02
W 0x00 0x80
W 0xCE 0x01 0x81 0xFF 0xFF 0x00 0xC8 0x00 0xC8
W 0x00 0x8C
W 0xCE 0x00 0x58 0x00 0x88
W 0x00 0x90
W 0xCE 0x00 0xA7 0x10 0x43 0x00 0xA7 0x80 0xFF 0xFF 0x00 0x04 0x00 0x0C 0x16
W 0x00 0xA0
W 0xCE 0x00 0x00 0x00
W 0x00 0xB0
W 0xCE 0x22 0x00 0x00
W 0x00 0xE1
W 0xCE 0x0A 0x02 0xB6 0x02 0xB6
W 0x00 0xF1
W 0xCE 0x1F 0x15
W 0x00 0xF4
W 0xCE 0x01 0x2C 0x00 0xED
W 0x00 0xB0
W 0xCF 0x00 0x00 0xAB 0xAF
W 0x00 0xB5
W 0xCF 0x05 0x05 0x07 0x0B
W 0x00 0xC0
W 0xCF 0x09 0x09 0x63 0x67
W 0x00 0xC5
W 0xCF 0x09 0x09 0x69 0x6D
W 0x00 0xF5
W 0xCF 0x00
W 0x00 0xD1
W 0xC1 0x08 0x0E 0x0B 0x4D 0x13 0x6C 0x05 0x52 0x07 0x79 0x0C 0xDB
W 0x00 0xE1
W 0xC1 0x0B 0x4D
W 0x00 0xE4
W 0xCF 0x09 0xAD 0x09 0xAC 0x09 0xAC 0x09 0xAC 0x09 0xAC 0x09 0xAC
W 0x00 0x80
W 0xC1 0x00 0x00
W 0x00 0x90
W 0xC1 0x03
W 0x00 0xCC
W 0xC1 0x18
W 0x00 0xE0
W 0xC1 0x00
W 0x00 0xF6
W 0xCF 0x5A
W 0x00 0x80
W 0xC2 0x82 0x01 0x1F 0x1F 0x00 0x00 0x00 0x00
W 0x00 0x90
W 0xC2 0x00 0x00 0x00 0x00
W 0x00 0xA0
W 0xC2 0x00 0x00 0x00 0x21 0x89 0x01 0x00 0x00 0x21 0x89 0x02 0x00 0x00 0x21 0x89
W 0x00 0xB0
W 0xC2 0x03 0x00 0x00 0x21 0x89 0x80 0x08 0x03 0x02 0x02
W 0x00 0xCA
W 0xC2 0x84 0x08 0x03 0x01 0x81
W 0x00 0xE0
W 0xC2 0x33 0x33 0x70 0x00 0x70
W 0x00 0xE8
W 0xC2 0x00 0x00 0x00 0x00 0x00 0x00 0x00 0x00
W 0x00 0xD0
W 0xC3 0x00 0x00 0x00 0x00 0x00 0x00 0x00 0x00 0x00 0x00 0x00 0x00 0x00 0x00 0x00 0x00
W 0x00 0x80
W 0xCB 0x00 0x01 0x00 0x03 0xFD 0x01 0x01 0x00 0x00 0x00 0xFD 0x01 0x00 0x03 0x00 0x00
W 0x00 0x90
W 0xCB 0x00 0x00 0x00 0x0F 0xF0 0x00 0x00 0x00 0x00 0x00 0xFF 0x00 0x00 0x00 0x00 0x00
W 0x00 0xA0
W 0xCB 0x00 0x00 0x00 0x00
W 0x00 0xA4
W 0xCB 0x03 0x00 0x0C 0x00
W 0x00 0xB0
W 0xCB 0x13 0x58 0x05 0x30
W 0x00 0xC0
W 0xCB 0x13 0x58 0x05 0x30
W 0x00 0xD5
W 0xCB 0x00 0x00 0x00 0x00 0x00 0x00 0x00 0x00 0x00 0x00 0x00
W 0x00 0xE0
W 0xCB 0x00 0x00 0x00 0x00 0x00 0x00 0x00 0x00 0x00 0x00 0x00 0x00 0x00
W 0x00 0x80
W 0xCC 0x23 0x12 0x23 0x1C 0x23 0x0A 0x23 0x23 0x09 0x08 0x07 0x06 0x23 0x23 0x23 0x23
W 0x00 0x90
W 0xCC 0x23 0x18 0x16 0x17 0x23 0x19 0x1A 0x1B
W 0x00 0xA0
W 0xCC 0x23 0x12 0x23 0x1D 0x23 0x0E 0x23 0x23 0x06 0x07 0x08 0x09 0x23 0x23 0x23 0x23
W 0x00 0xB0
W 0xCC 0x23 0x18 0x16 0x17 0x23 0x19 0x1A 0x1B
W 0x00 0x80
W 0xCD 0x23 0x23 0x23 0x02 0x23 0x0A 0x23 0x23 0x09 0x08 0x07 0x06 0x23 0x23 0x23 0x23
W 0x00 0x90
W 0xCD 0x23 0x18 0x16 0x17 0x23 0x19 0x1A 0x1B
W 0x00 0xA0
W 0xCD 0x23 0x23 0x23 0x02 0x23 0x0E 0x23 0x23 0x06 0x07 0x08 0x09 0x23 0x23 0x23 0x23
W 0x00 0xB0
W 0xCD 0x23 0x18 0x16 0x17 0x23 0x19 0x1A 0x1B
W 0x00 0x86
W 0xC0 0x00 0x00 0x00 0x01 0x19 0x05
W 0x00 0x96
W 0xC0 0x00 0x00 0x00 0x01 0x19 0x05
W 0x00 0xA3
W 0xCE 0x00 0x00 0x00 0x01 0x19 0x05
W 0x00 0xB3
W 0xCE 0x00 0x00 0x00 0x01 0x19 0x05
W 0x00 0x69
W 0xC0 0x01 0x14 0x01
W 0x00 0x82
W 0xA7 0x10 0x00
W 0x00 0x8D
W 0xA7 0x01
W 0x00 0x8F
W 0xA7 0x01
W 0x00 0x93
W 0xC5 0x37
W 0x00 0x97
W 0xC5 0x37
W 0x00 0x9A
W 0xC5 0x32
W 0x00 0x9C
W 0xC5 0x32
W 0x00 0xB6
W 0xC5 0x10 0x10 0x0E 0x0E 0x10 0x10 0x0E 0x0E
W 0x00 0x88
W 0xC4 0x08
W 0x00 0x80
W 0xA7 0x03
W 0x00 0xB0
W 0xC5 0xD1
W 0x00 0xB3
W 0xC5 0xD1
W 0x00 0x99
W 0xCF 0x50
W 0x00 0x8C
W 0xC3 0x00
W 0x00 0xA0
W 0xC3 0x35 0x21
W 0x00 0xA4
W 0xC3 0x01 0x20
W 0x00 0xAA
W 0xC3 0x21
W 0x00 0xAD
W 0xC3 0x01
W 0x00 0xAE
W 0xC3 0x20
W 0x00 0xB3
W 0xC3 0x21
W 0x00 0xB6
W 0xC3 0x01 0x20
W 0x00 0xC3
W 0xC5 0xFF
W 0x00 0xA9
W 0xF5 0x8E
W 0x00 0xB0
W 0xB3 0x00
W 0x00 0x83
W 0xB0 0x63
W 0x00 0x93
W 0xC4 0x08
W 0x00 0x80
W 0xB3 0x22
W 0x00 0x90
W 0xC3 0x08
W 0x00 0xFA
W 0xC2 0x14
W 0x00 0xCA
W 0xC0 0x80
W 0x00 0x82
W 0xF5 0x01
W 0x00 0x93
W 0xF5 0x01
W 0x00 0x9B
W 0xF5 0x49
W 0x00 0x9D
W 0xF5 0x49
W 0x00 0xBE
W 0xC5 0xF0 0xF0
W 0x00 0x85
W 0xA7 0x01
W 0x00 0xDC
W 0xC3 0x37
W 0x00 0x8A
W 0xF5 0xC7
W 0x00 0x99
W 0xCF 0x50
W 0x00 0x9C
W 0xF5 0x00
W 0x00 0x9E
W 0xF5 0x00
W 0x00 0xB0
W 0xC5 0xD0 0x4A 0x39 0xD0 0x4A 0x0F
W 0x00 0xC2
W 0xF5 0x42
W 0x00 0xE8
W 0xC0 0x40
W 0x00 0xD4
W 0xCB 0x03
W 0x00 0xB0
W 0xCA 0x6B 0x6B 0x09
W 0x00 0xB0
W 0xB4 0x00 0x08 0x02 0x00 0x00 0xBB 0x00 0x07 0x0D 0xB7 0x0C 0xB7 0x10 0xF0
W 0x00 0x80
W 0xA4 0xCA
W 0x00 0x87
W 0xC5 0x0C
W 0x00 0x89
W 0xC5 0x0C 0x0C 0x0C
W 0x00 0x8C
W 0xC5 0x0C 0x0C 0x0C
W 0x00 0xB5
W 0xCA 0x00
W 0x00 0xA0
W 0xCA 0x08 0x08 0x08
W 0x00 0x80
W 0xCA 0xE6 0xD1 0xC1 0xB4 0xAB 0xA2 0x9B 0x95 0x8F 0x8B 0x8D 0x81
W 0x00 0x90
W 0xCA 0xFE 0xFF 0x66 0xFC 0xFF 0xCC 0xFA 0xFF 0x66
W 0x00 0x00
W 0xFF 0xFF 0xFF 0xFF
W 0x53 0x2C
W 0x55 0x01
						    W 0x11
Delay 120ms
W 0x29";
		samsung,mdss_dsi_on_tx_cmds_revA_lp; /* Without this feature, whole ss commands be sent on HS mode */

		samsung,mdss_dsi_off_tx_cmds_revA = "W 0x28
Delay 20ms
W 0x10
Delay 70ms";

		qcom,mdss-dsi-display-timings {
			fhd {
				qcom,display-topology = <1 1 1>;
				qcom,default-topology-index = <0>;

				qcom,mdss-dsi-panel-width = <1080>;
				qcom,mdss-dsi-panel-height = <2408>;

				qcom,mdss-dsi-h-pulse-width = <12>;
				qcom,mdss-dsi-h-back-porch = <181>;
				qcom,mdss-dsi-h-front-porch = <289>;
				qcom,mdss-dsi-h-sync-skew = <0>;
				qcom,mdss-dsi-v-pulse-width = <2>;
				qcom,mdss-dsi-v-back-porch = <18>;
				qcom,mdss-dsi-v-front-porch = <46>; /* 1283 for 60hz, 46 for 90hz */
				qcom,mdss-dsi-panel-clockrate = <1125000000>; /* 1125 Mbps*/
				qcom,mdss-dsi-panel-phy-timings = [00 25 0A 0A 1B 24 0A 0A 0A 02 04 00 1F 0F];
				qcom,mdss-dsi-t-clk-pre = <0x1F>;
				qcom,mdss-dsi-t-clk-post = <0x0F>;

				qcom,mdss-dsi-panel-framerate = <90>;
				/* qcom,mdss-mdp-transfer-time-us = <7533>; */

				/*qcom,mdss-dsi-timing-switch-command; use samsung,panel_multires_XXX instead*/
				/*qcom,mdss-dsi-timing-switch-command-state;*/

				qcom,mdss-dsi-on-command-state = "dsi_lp_mode";
				qcom,mdss-dsi-off-command-state = "dsi_hs_mode";

				qcom,compression-mode = "dsc";
				qcom,mdss-dsc-version = <0x11>;
				qcom,mdss-dsc-scr-version = <0>;
				qcom,mdss-dsc-slice-height = <8>;
				qcom,mdss-dsc-slice-width = <540>;
				qcom,mdss-dsc-slice-per-pkt = <1>;
				qcom,mdss-dsc-bit-per-component = <8>;
				qcom,mdss-dsc-bit-per-pixel = <8>;
				qcom,mdss-dsc-block-prediction-enable;
			};
		};
	};
};

/* from a23/a23_eur_open_w00_r08.dts */
&A23_FT8720_LPS066A767A {
	qcom,display-type = "primary";
	qcom,dsi-ctrl-num = <0>;
	qcom,dsi-phy-num = <0>;

	/delete-property/ qcom,panel-mode-gpio;


	samsung,ub-con-det = <SEC_GPIO_REF(AP,tlmm,19) 0>;

	samsung,esd-irq-gpio1 = <SEC_GPIO_REF(AP,tlmm,35) 0>; /* DISP_DET */


	qcom,panel-supply-entries
	{
		#address-cells = <1>;
		#size-cells = <0>;

		/* display on: 1.8V -> 3ms -> 5.5V -> 3ms -> -5.5V -> 10ms
		 * -> reset high -> 3ms-> reset low -> 1ms -> reset high
		 * -> 10ms -> display config1 ->  sleep out -> 120ms
		 * -> display on -> 40ms -> backlight on
		 */
		/* display off: backlight off -> 10ms -> display off -> 20ms
		 * -> sleep in -> 70ms -> reset low -> 3ms -> -5.5V -> 1ms
		 * -> 5.5V -> 3ms ->  vddi off
		 */
		qcom,panel-supply-entry@0 {
			reg = <0>;
			qcom,supply-name = "lcd_vddi"; /* VDD 1.8V */
			qcom,supply-min-voltage = <1800000>;
			qcom,supply-max-voltage = <1800000>;
			qcom,supply-enable-load = <100000>;
			qcom,supply-disable-load = <100>;
			qcom,supply-pre-on-sleep = <0>; /* unit is ms*/
			qcom,supply-post-on-sleep = <3>;
			qcom,supply-post-off-sleep = <32>;
		};

		qcom,panel-supply-entry@1 {
			reg = <1>;
			qcom,supply-name = "lcd_vsp";
			qcom,supply-min-voltage = <1800000>;
			qcom,supply-max-voltage = <1800000>;
			qcom,supply-enable-load = <100000>;
			qcom,supply-disable-load = <100>;
			qcom,supply-pre-on-sleep = <0>; /* unit is ms*/
			qcom,supply-post-on-sleep = <5>;
			qcom,supply-post-off-sleep = <5>;
		};
		qcom,panel-supply-entry@2 {
			reg = <2>;
			qcom,supply-name = "lcd_vsn";
			qcom,supply-min-voltage = <1800000>;
			qcom,supply-max-voltage = <1800000>;
			qcom,supply-enable-load = <100000>;
			qcom,supply-disable-load = <100>;
			qcom,supply-pre-on-sleep = <0>; /* unit is ms*/
			qcom,supply-post-on-sleep = <10>;
			qcom,supply-post-off-sleep = <3>;
		};

		qcom,panel-supply-entry@4 {
			reg = <4>;
			qcom,supply-name = "lcd_rst";
			qcom,supply-min-voltage = <1800000>;
			qcom,supply-max-voltage = <1800000>;
			qcom,supply-enable-load = <100000>;
			qcom,supply-disable-load = <100>;
			qcom,supply-pre-on-sleep = <0>; /* unit is ms*/
			qcom,supply-post-on-sleep = <10>;
			qcom,supply-post-off-sleep = <5>;
		};
	};
};

/* from a23/a23_eur_open_w00_r08.dts */
&ss_dsi_panel_NT36672C_PM6585JB3_FHD {
	qcom,dsi-select-clocks = "mux_byte_clk0", "mux_pixel_clk0";
};

/* from a23/a23_eur_open_w00_r08.dts */
&A23_ILI7807S_BS066FBM {
	qcom,dsi-select-clocks = "mux_byte_clk0", "mux_pixel_clk0";
};

/* from a23/a23_eur_open_w00_r08.dts */
&A23_NT36672C_TCFJ6606 {
	qcom,dsi-select-clocks = "mux_byte_clk0", "mux_pixel_clk0";
};

/* from a23/a23_eur_open_w00_r08.dts */
&A23_FT8720_LPS066A767A {
	qcom,dsi-select-clocks = "mux_byte_clk0", "mux_pixel_clk0";
};

/* from a23/a23_eur_open_w00_r08.dts */
&ss_dsi_panel_PBA_BOOTING_FHD {
	qcom,dsi-select-clocks = "mux_byte_clk0", "mux_pixel_clk0";
	qcom,mdss-dsi-pba-regulator_ss;

	qcom,mdss-dsi-display-timings {
		fhd@0 {
			qcom,mdss-dsi-panel-phy-timings = [00 1E 08 07 18 22 08 08 08 08 02 04 1A 0D];
		};
	};

	qcom,panel-supply-entries
	{
		#address-cells = <1>;
		#size-cells = <0>;

		qcom,panel-supply-entry@0 {
			reg = <0>;
			qcom,supply-name = "lcd_vddi"; /* VDD 1.8V */
			qcom,supply-min-voltage = <1800000>;
			qcom,supply-max-voltage = <1800000>;
			qcom,supply-enable-load = <100000>;
			qcom,supply-disable-load = <100>;
			qcom,supply-pre-on-sleep = <0>; /* unit is ms*/
			qcom,supply-post-on-sleep = <1>;
			qcom,supply-post-off-sleep = <2>;
		};

		qcom,panel-supply-entry@1 {
			reg = <1>;
			qcom,supply-name = "lcd_vsp";
			qcom,supply-min-voltage = <1800000>;
			qcom,supply-max-voltage = <1800000>;
			qcom,supply-enable-load = <100000>;
			qcom,supply-disable-load = <100>;
			qcom,supply-pre-on-sleep = <0>; /* unit is ms*/
			qcom,supply-post-on-sleep = <2>;
			qcom,supply-post-off-sleep = <4>;
		};
		qcom,panel-supply-entry@2 {
			reg = <2>;
			qcom,supply-name = "lcd_vsn";
			qcom,supply-min-voltage = <1800000>;
			qcom,supply-max-voltage = <1800000>;
			qcom,supply-enable-load = <100000>;
			qcom,supply-disable-load = <100>;
			qcom,supply-pre-on-sleep = <0>; /* unit is ms*/
			qcom,supply-post-on-sleep = <13>;
			qcom,supply-post-off-sleep = <2>;
		};

		qcom,panel-supply-entry@3 {
			reg = <3>;
			qcom,supply-name = "lcd_rst";
			qcom,supply-min-voltage = <1800000>;
			qcom,supply-max-voltage = <1800000>;
			qcom,supply-enable-load = <100000>;
			qcom,supply-disable-load = <100>;
			qcom,supply-pre-on-sleep = <0>; /* unit is ms*/
			qcom,supply-post-on-sleep = <10>;
			qcom,supply-post-off-sleep = <1>;
		};
	};	
};

/* from a23/a23_eur_open_w00_r08.dts */
&sde_dsi {
	qcom,dsi-default-panel = <&ss_dsi_panel_NT36672C_PM6585JB3_FHD>;

	pinctrl-names = "panel_active", "panel_suspend";
	pinctrl-0 = <&panel_jb3_ubcon_active &panel_jb3_esd_1_active>;
	pinctrl-1 = <&panel_jb3_ubcon_suspend &panel_jb3_esd_1_suspend>;
};
